## prj.conf
```kconfig
# Iface library
CONFIG_CK_IFACE_LIB_SOCKETS=y

# Logging
CONFIG_LOG=y
CONFIG_LOG_MODE_IMMEDIATE=y
CONFIG_LOG_BACKEND_SHOW_COLOR=y

# System
CONFIG_TEST_RANDOM_GENERATOR=y
CONFIG_ENTROPY_GENERATOR=y
CONFIG_NEWLIB_LIBC=y
CONFIG_MAIN_STACK_SIZE=10000

# Networking config
CONFIG_NETWORKING=y
CONFIG_NET_CONFIG_AUTO_INIT=y
CONFIG_NET_CONFIG_SETTINGS=y
CONFIG_NET_IPV4=y
CONFIG_NET_DHCPV4=y
CONFIG_NET_CONFIG_NEED_IPV4=y
CONFIG_DNS_RESOLVER=y

# Thread-Aware debugging
CONFIG_THREAD_MONITOR=y
CONFIG_INIT_STACKS=y
CONFIG_DEBUG_THREAD_INFO=y
CONFIG_THREAD_STACK_INFO=y
CONFIG_THREAD_NAME=y

# Disable code for debuggin
CONFIG_DEBUG_OPTIMIZATIONS=y
CONFIG_EXCEPTION_STACK_TRACE=y

# Ethernet (Nucleo-H743ZI on-board MAC + LAN8742 PHY)
CONFIG_NET_L2_ETHERNET=y
CONFIG_NET_UDP=y

# mDNS resolution: resolve iface-server.local (DNS_RESOLVER is enabled above).
CONFIG_MDNS_RESOLVER=y
```

## src/main.c
```c
// Standard includes
#include <errno.h>
#include <stdio.h>
#include <string.h>

// Zephyr includes
#include <zephyr/device.h>
#include <zephyr/kernel.h>
#include <zephyr/logging/log.h>
#include <zephyr/net/dns_resolve.h>
#include <zephyr/net/net_config.h>
#include <zephyr/net/net_context.h>
#include <zephyr/net/net_core.h>
#include <zephyr/net/net_if.h>
#include <zephyr/net/net_mgmt.h>
#include <zephyr/net/socket.h>

// Corekinect includes
#include <corekinect/iface/iface.h>  // <- This is how you'd include the library in your app

LOG_MODULE_REGISTER(socket_client);

// Configuration
// The server advertises itself over mDNS (see socket_server: CONFIG_NET_HOSTNAME
// + CONFIG_MDNS_RESPONDER). The iface lib resolves any non-numeric host via
// DNS/mDNS, so no hardcoded addresses: both boards get DHCP leases and find
// each other by name.
#define SERVER_HOST "iface-server.local"
#define SERVER_PORT 4444

// Useful networking information
static void print_net_addr(void);

int main(void)
{
    print_net_addr();

    // Client config
    iface_t client_cfg =
    {
        .type = IFACE_TYPE_SOCKET,
        .link = IFACE_LINK_TYPE_CLIENT,
        .p_host = SERVER_HOST,
        .port = SERVER_PORT,
    };

    // Main loop
    while (true)
    {
        if (!iface_create(&client_cfg))
        {
            LOG_ERR("Could not create iface");
            break;
        }

        LOG_INF("Client is connecting to server...");

        bool timeout = false;
        if (!iface_connect(&client_cfg, &timeout))
        {
            LOG_ERR("Could not connect, timeout: %s", timeout ? "yes" : "no");
            break;
        }

        LOG_INF("Connected succesfully!");

        bool conn_closed = false;
        uint8_t count = 0;
        while (count < 3)
        {
            char message[] = "Hello from client";
            LOG_INF("Client sending: %s", message);

            uint16_t sent_bytes = 0;
            if (!iface_send(&client_cfg, message, sizeof(message), &sent_bytes, &conn_closed, &timeout))
            {
                LOG_ERR("Could not send, timeout: %s, conn_closed: %s", timeout ? "yes" : "no", conn_closed ? "yes" : "no");
                break;
            }

            uint16_t recv_bytes = 0;
            static char buffer[1024] = {0};
            if (!iface_recv(&client_cfg, buffer, sizeof(buffer), &recv_bytes, &conn_closed, &timeout))
            {
                LOG_ERR("Could not recv, timeout: %s, conn_closed: %s", timeout ? "yes" : "no", conn_closed ? "yes" : "no");
                break;
            }

            LOG_INF("Client received: %s", buffer);
            count++;
            k_msleep(1000);
        }

        if (!iface_close(&client_cfg))
        {
            LOG_ERR("Could not close iface");
            break;
        }

        k_msleep(1000);
    }

    LOG_ERR("Fatal error occurred in %s", __func__);
    k_fatal_halt(0);
}

static void print_net_addr(void)
{
    struct net_if *iface;
    iface = net_if_get_default();
    char buf[NET_IPV4_ADDR_LEN];

    for (size_t i = 0; i < NET_IF_MAX_IPV4_ADDR; i++)
    {
        // Zephyr 4.x: address moved to unicast[i].ipv4, netmask is per-address
        if (!iface->config.ip.ipv4->unicast[i].ipv4.is_used)
        {
            continue;
        }

        LOG_INF("IP Addr: %s",
                net_addr_ntop(AF_INET,
                              &iface->config.ip.ipv4->unicast[i].ipv4.address.in_addr,
                              buf, sizeof(buf)));

        LOG_INF("Subnet: %s",
                net_addr_ntop(AF_INET,
                              &iface->config.ip.ipv4->unicast[i].netmask,
                              buf, sizeof(buf)));
        LOG_INF("Router: %s",
                net_addr_ntop(AF_INET,
                              &iface->config.ip.ipv4->gw,
                              buf, sizeof(buf)));
    }

    const struct dns_resolve_context *ctx = dns_resolve_get_default();

    for (int i = 0; ctx->servers[i].dns_server.sa_family != AF_UNSPEC; ++i)
    {
        if (ctx->servers[i].dns_server.sa_family == AF_INET)
        {
            // If the address is IPV4, then print it
            struct sockaddr_in *dns_addr = (struct sockaddr_in *)&ctx->servers[i].dns_server;

            LOG_INF("Resolver [%d]: %s", i,
                    net_addr_ntop(AF_INET, &dns_addr->sin_addr, buf, sizeof(buf)));
        }
    }
}
```
