/dts-v1/;
/plugin/;

#include <dt-bindings/gpio/gpio.h>
/ {
    compatible = "toradex,verdin-imx8mm";
};

&ecspi2 {
    #address-cells = <1>;
    #size-cells = <0>;
    status = "okay";
    
    spidev@0 {
        status = "disabled";
    };
    
    ad7689@0 {
        compatible = "adi,ad7689";
        reg = <0>;
        spi-max-frequency = <40000000>;
        status = "okay";
        adi,internal-ref-microvolt = <4096000>;  
    };
};