// SPDX-License-Identifier: GPL-2.0
/dts-v1/;
/plugin/;

#include <dt-bindings/clock/imx8mm-clock.h>

&{/} {
    compatible = "toradex,verdin-imx8mm";
};

&usbotg1 {
    maximum-speed = "full-speed";  /* Forces USB 1.1 */
    samsung,picophy-dc-vol-level-adjust = <7>;
    samsung,picophy-pre-emp-curr-control = <3>;
};

&usbotg2 {
    maximum-speed = "full-speed";  /* Forces USB 1.1 */
    samsung,picophy-dc-vol-level-adjust = <7>;
    samsung,picophy-pre-emp-curr-control = <3>;
};