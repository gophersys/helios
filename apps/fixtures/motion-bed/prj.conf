## CMakeLists.txt
```
cmake_minimum_required(VERSION 3.20.0)

find_package(Zephyr)

project(motion-bed)

# Hardcoded root path
set(MONOREPO_ROOT "/workspaces/concord")
set(MONOREPO_ROOT ${MONOREPO_ROOT} CACHE INTERNAL "Monorepo root directory")

# Cipher Library
zephyr_include_directories(${MONOREPO_ROOT}/libs/cipher/include)
zephyr_include_directories(${MONOREPO_ROOT}/libs/cipher/test/include)
add_subdirectory(${MONOREPO_ROOT}/libs/cipher ${CMAKE_CURRENT_BINARY_DIR}/_libs/cipher)

# Services
zephyr_include_directories(${MONOREPO_ROOT}/services/fixtures/motion-bed/c)
add_subdirectory(${MONOREPO_ROOT}/services/fixtures/motion-bed/c ${CMAKE_CURRENT_BINARY_DIR}/_services/motion-bed)

target_sources(app PRIVATE src/main.c)
```

## prj.conf
```kconfig
# Logging
CONFIG_LOG=y
CONFIG_LOG_MODE_IMMEDIATE=y
# CONFIG_LOG_MODE_DEFERRED=y
CONFIG_BOOT_BANNER=n
CONFIG_ASSERT=y
CONFIG_POLL=y

# Scheduler
CONFIG_NUM_PREEMPT_PRIORITIES=121

# Thread analyzer
# CONFIG_THREAD_ANALYZER=y
# CONFIG_THREAD_ANALYZER_USE_LOG=y
# CONFIG_THREAD_ANALYZER_AUTO=y
# CONFIG_THREAD_ANALYZER_AUTO_INTERVAL=5

# Set log level to debug for maximum output
# CONFIG_LOG_DEFAULT_LEVEL=4

# Enable log processing at boot to capture early logs
# CONFIG_BOOT_TIME_MEASUREMENT=y

# General config
CONFIG_NEWLIB_LIBC=y
CONFIG_MAIN_STACK_SIZE=1200

# Networking config
CONFIG_NETWORKING=y
CONFIG_NET_LOOPBACK=y
CONFIG_NET_LOOPBACK_LOG_LEVEL_DBG=y
CONFIG_NET_IPV4=y
CONFIG_NET_IPV6=n
CONFIG_NET_TCP=y
CONFIG_NET_SOCKETS=y
CONFIG_NET_SOCKETS_POSIX_NAMES=y

# Socket options
CONFIG_NET_CONTEXT_SNDTIMEO=y
CONFIG_NET_CONTEXT_RCVTIMEO=y

# Network driver config
# CONFIG_TEST_RANDOM_GENERATOR=y

# Network address config
CONFIG_NET_CONFIG_SETTINGS=y
CONFIG_NET_CONFIG_NEED_IPV4=y
CONFIG_NET_CONFIG_MY_IPV4_ADDR="192.168.0.10"
CONFIG_NET_CONFIG_MY_IPV4_NETMASK="255.0.0.0"

# Threads
CONFIG_PRINTK=y
CONFIG_HEAP_MEM_POOL_SIZE=256
CONFIG_ASSERT=y
CONFIG_GPIO=y

# Thread-Aware debugging
CONFIG_THREAD_MONITOR=y
CONFIG_INIT_STACKS=y
CONFIG_DEBUG_THREAD_INFO=y
CONFIG_THREAD_STACK_INFO=y
CONFIG_THREAD_NAME=y

# -- disable code optimization so we can debug
CONFIG_DEBUG_OPTIMIZATIONS=y
CONFIG_EXCEPTION_STACK_TRACE=y
CONFIG_DEBUG_INFO=y
CONFIG_ASSERT=y

# -- system debug options
# CONFIG_SYS_HEAP_VALIDATE=y
# CONFIG_STACK_SENTINEL=y
# CONFIG_USERSPACE=y

# Useful to detect stack overflows
# CONFIG_STACK_CANARIES=y
# CONFIG_DYNAMIC_OBJECTS=y
# CONFIG_HEAP_MEM_POOL_SIZE=100000
```

## src/main.c
```c
// Zephyr includes
#include <zephyr/kernel.h>
#include <zephyr/logging/log.h>
#include <zephyr/net/net_ip.h>
#include <zephyr/net/socket.h>
#include <zephyr/posix/netinet/in.h>
#include <zephyr/posix/sys/socket.h>

LOG_MODULE_REGISTER(app);

// Cipher includes
#include "daemon/api.h"
#include "daemon/fifo.h"
#include "daemon/registry.h"
#include "utils/err.h"

// App includes
#include "config.h"
#include "motion-bed.h"

int main(void) {
    LOG_RAW("\n\n%s\n", "********** Motion Bed App **********");

    // Create a new daemon instance
    cipher_daemon_init(&cfg, &d);

    // Register all services for this device
    size_t num_services = 0;
    cipher_service_entry_t* services = accel_fixture_get_services(&num_services);
    cipher_register_local_services(&d, services, num_services);

    // Let it rip
    cipher_daemon_start(&d);

    while (true) {
        k_msleep(1000);
    }
}

motion_response_t accel_bench_rpc_command_motion_handler(motion_request_t request) {
    static int count = 0;
    motion_response_t response = {0};
    LOG("Calling RPC %d", count++);
    return response;
}
```

## src/config.h
```c
#ifndef APP_CONFIG_H
#define APP_CONFIG_H

#include <zephyr/kernel.h>

#include "daemon/daemon.h"
#include "transport/transport.h"

#define THIS_DEVICE_ID 124
#define DOWNLINK_SOCKET 5000  // Server listens on this port

static cipher_daemon_config_t cfg = {
    .device_id = THIS_DEVICE_ID,
    .downlink_ifaces[0] = {
        .type = TAL_INTERFACE_TYPE_SOCKET,
        .link = TAL_LINK_TYPE_DOWNLINK,
        .host = NULL,  // Not needed for downlink
        .port = DOWNLINK_SOCKET,
    },
    .num_uplink_ifaces = 0,
    .num_downlink_ifaces = 1,
};

static cipher_daemon_t d = {0};

#endif
```
