## CMakeLists.txt
```
cmake_minimum_required(VERSION 3.20.0)


find_package(Zephyr)

project(alt-runner)

# Hardcoded root path
set(MONOREPO_ROOT "/workspaces/concord")
set(MONOREPO_ROOT ${MONOREPO_ROOT} CACHE INTERNAL "Monorepo root directory")

# Cipher Library
zephyr_include_directories(${MONOREPO_ROOT}/libs/cipher/include)
zephyr_include_directories(${MONOREPO_ROOT}/libs/cipher/test/include)
add_subdirectory(${MONOREPO_ROOT}/libs/cipher ${CMAKE_CURRENT_BINARY_DIR}/_libs/cipher)

# Local Services (offered)

# Remote Services (consumed)
zephyr_include_directories(${MONOREPO_ROOT}/services/tests/alt-drv-test-srvc/c)
add_subdirectory(${MONOREPO_ROOT}/services/tests/alt-drv-test-srvc/c ${CMAKE_CURRENT_BINARY_DIR}/_services/alt-drv-test-srvc)

target_sources(app PRIVATE src/main.c src/config/config.c)
```

## prj.conf
```kconfig
# Logging
CONFIG_LOG=y
CONFIG_LOG_MODE_IMMEDIATE=y
CONFIG_LOG_BACKEND_SHOW_COLOR=y
# CONFIG_LOG_MODE_DEFERRED=y
CONFIG_BOOT_BANNER=n
CONFIG_ASSERT=y
CONFIG_POLL=y

CONFIG_GPIO=y

# Scheduler
CONFIG_NUM_PREEMPT_PRIORITIES=121

# Thread analyzer
# CONFIG_THREAD_ANALYZER=y
# CONFIG_THREAD_ANALYZER_USE_LOG=y
# CONFIG_THREAD_ANALYZER_AUTO=y
# CONFIG_THREAD_ANALYZER_AUTO_INTERVAL=5

# Set log level to debug for maximum output
# CONFIG_LOG_DEFAULT_LEVEL=4

# Enable log processing at boot to capture early logs
# CONFIG_BOOT_TIME_MEASUREMENT=y

# General config
CONFIG_NEWLIB_LIBC=y
CONFIG_MAIN_STACK_SIZE=1200

# Networking config
CONFIG_NETWORKING=y
# CONFIG_NET_LOOPBACK=y
# CONFIG_NET_LOOPBACK_LOG_LEVEL_DBG=y
CONFIG_NET_IPV4=y
CONFIG_NET_DHCPV4=n
CONFIG_NET_IPV6=n
CONFIG_NET_TCP=y
CONFIG_NET_SOCKETS=y
CONFIG_NET_SOCKETS_POSIX_NAMES=y

# Socket options
CONFIG_NET_CONTEXT_SNDTIMEO=y
CONFIG_NET_CONTEXT_RCVTIMEO=y

# Network driver config
# CONFIG_TEST_RANDOM_GENERATOR=y

# Network address config
CONFIG_NET_CONFIG_SETTINGS=y
CONFIG_NET_CONFIG_NEED_IPV4=y
CONFIG_NET_CONFIG_MY_IPV4_ADDR="192.168.0.71"
CONFIG_NET_CONFIG_MY_IPV4_NETMASK="255.0.0.0"

# Threads
CONFIG_PRINTK=y
CONFIG_HEAP_MEM_POOL_SIZE=256
CONFIG_ASSERT=y
CONFIG_GPIO=y

# Thread-Aware debugging
CONFIG_THREAD_MONITOR=y
CONFIG_INIT_STACKS=y
CONFIG_DEBUG_THREAD_INFO=y
CONFIG_THREAD_STACK_INFO=y
CONFIG_THREAD_NAME=y

# -- disable code optimization so we can debug
CONFIG_DEBUG_OPTIMIZATIONS=y
CONFIG_EXCEPTION_STACK_TRACE=y
CONFIG_DEBUG_INFO=y
CONFIG_ASSERT=y

# -- system debug options
# CONFIG_SYS_HEAP_VALIDATE=y
# CONFIG_STACK_SENTINEL=y
# CONFIG_USERSPACE=y

# Useful to detect stack overflows
# CONFIG_STACK_CANARIES=y
# CONFIG_DYNAMIC_OBJECTS=y
# CONFIG_HEAP_MEM_POOL_SIZE=100000
```

## app.overlay
```dts
&lpuart1 {
    current-speed = <0xe1000>;
};
```

## src/main.c
```c
// Zephyr includes
#include <zephyr/kernel.h>
#include <zephyr/logging/log.h>

// Cipher includes
#include "daemon/api.h"

// App includes
#include "alt-drv-test-srvc.h"  // We consume this service from the test app
#include "config/config.h"      // Network configuration of cluster

LOG_MODULE_REGISTER(app);

int main(void) {
    LOG_RAW("%s", "********** Alt Drv Runner App **********");

    // Create a new daemon instance
    cipher_daemon_config_t* cfg = get_app_config();
    cipher_daemon_t* d = get_app_daemon();
    cipher_daemon_init(cfg, d);

    size_t num_remote_services = 0;
    cipher_service_entry_t* remote_services = alt_drv_test_get_services(&num_remote_services);
    cipher_register_remote_services(d, remote_services, num_remote_services);  // Services we consume

    // Start
    cipher_daemon_start(d);

    k_msleep(2000);  // Await for service discovery

    while (true) {

        cipher_rpc_user_info_t info = {
            .device_id = 123,
            .timeout_ms = 5000,
        };

        test_request_t request = {};

        uint32_t start_time = k_uptime_get_32();
        test_response_t response = alt_drv_test_rpc_begin_test(d, &info, request);
        if (info.error != CIPHER_RPC_ERR_OK) {
            ERROR("Could not execute test RPC: %d", info.error);
        }
        LOG("RPC alt_drv_test_rpc_begin_test succeeded! (%dms)", k_uptime_get_32() - start_time);

        if (response.success) {
            LOG("Test Passed!");
        }

        k_msleep(1000);
    }
}
```
