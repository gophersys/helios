## CMakeLists.txt
```
# SPDX-License-Identifier: Apache-2.0
# ICLE Zephyr Firmware for ESP32
#
# CoreKinect In-Circuit Loop-back Equipment (ICLE) v1.0
# ESP32-WROOM-32 based test fixture for DUT validation

cmake_minimum_required(VERSION 3.20.0)

# Custom board directory for icle_v1_0 board
# Uncomment when custom board definition is finalized:
# list(APPEND BOARD_ROOT ${CMAKE_CURRENT_SOURCE_DIR}/../../../../libs/embedded/ck_board)

find_package(Zephyr REQUIRED HINTS $ENV{ZEPHYR_BASE})

project(icle_zephyr VERSION 1.0.0)

# =============================================================================
# Source Files - Organized by Directory
# =============================================================================

# Application layer - state machine and events
set(APP_SOURCES
    src/main_new.c
    src/app/events.c
    src/app/state_machine.c
)

# Network layer - WiFi (via netctl) and heartbeat
set(NET_SOURCES
    src/net/wifi.c
    src/net/heartbeat.c
)

# Network Control Service (ported from Helios runtime)
set(NETCTL_SOURCES
    src/services/netctl/netctl.c
    src/services/netctl/profile.c
    src/services/netctl/arbiter.c
    src/services/netctl/wifi/wifi_sta.c
)

# HAL layer - hardware abstraction
set(HAL_SOURCES
    src/hal/gpio.c
    src/hal/power_monitor.c
    src/hal/button.c
    src/hal/storage.c
)

# Services layer - business logic
set(SERVICES_SOURCES
    src/services/logger.c
    src/services/config_manager.c
    src/services/ota.c
    src/services/http.c
    src/services/pm.c
    src/services/shell_cmds.c
)

# Utilities
set(UTIL_SOURCES
    src/util/json_builder.c
)

# Combine all sources
target_sources(app PRIVATE
    ${APP_SOURCES}
    ${NET_SOURCES}
    ${NETCTL_SOURCES}
    ${HAL_SOURCES}
    ${SERVICES_SOURCES}
    ${UTIL_SOURCES}
)

# =============================================================================
# Include Directories
# =============================================================================

target_include_directories(app PRIVATE
    ${CMAKE_CURRENT_SOURCE_DIR}/src
    ${CMAKE_CURRENT_SOURCE_DIR}/include
)

# =============================================================================
# Compiler Definitions
# =============================================================================

target_compile_definitions(app PRIVATE
    ICLE_VERSION_MAJOR=${PROJECT_VERSION_MAJOR}
    ICLE_VERSION_MINOR=${PROJECT_VERSION_MINOR}
    ICLE_VERSION_PATCH=${PROJECT_VERSION_PATCH}
)
```

## prj.conf
```kconfig
# SPDX-License-Identifier: Apache-2.0
# ICLE Zephyr Firmware Configuration
# ESP32-WROOM-32 based test fixture for DUT validation

# =============================================================================
# System Configuration
# =============================================================================

# Use newlib libc (SDK compatibility)
CONFIG_NEWLIB_LIBC=y

# Main stack - app event loop runs on main thread, needs 4096+
CONFIG_MAIN_STACK_SIZE=4096
CONFIG_HEAP_MEM_POOL_SIZE=16384

# System workqueue stack - ESP32 WiFi driver processes events here,
# needs 4096+ for scan/connect/DHCP operations
CONFIG_SYSTEM_WORKQUEUE_STACK_SIZE=4096

# Thread support
CONFIG_MULTITHREADING=y
CONFIG_NUM_PREEMPT_PRIORITIES=16
CONFIG_THREAD_NAME=y
CONFIG_THREAD_STACK_INFO=y

# Events for state machine
CONFIG_EVENTS=y

# =============================================================================
# Logging
# =============================================================================

CONFIG_LOG=y
CONFIG_LOG_MODE_IMMEDIATE=y
CONFIG_LOG_BUFFER_SIZE=2048
CONFIG_LOG_DEFAULT_LEVEL=3
CONFIG_LOG_MAX_LEVEL=4
CONFIG_LOG_PRINTK=y
CONFIG_LOG_RUNTIME_FILTERING=y

# =============================================================================
# Console and Shell
# =============================================================================

CONFIG_CONSOLE=y
CONFIG_UART_CONSOLE=y
CONFIG_SERIAL=y
CONFIG_SHELL=y
CONFIG_SHELL_BACKEND_SERIAL=y
CONFIG_SHELL_STACK_SIZE=1536

# =============================================================================
# GPIO
# =============================================================================

CONFIG_GPIO=y
CONFIG_PINCTRL=y

# =============================================================================
# I2C for INA209 Power Monitor
# =============================================================================

CONFIG_I2C=y
CONFIG_SENSOR=y

# =============================================================================
# SPI for SD Card
# =============================================================================

CONFIG_SPI=y

# =============================================================================
# SD Card and Filesystem
# =============================================================================

CONFIG_DISK_ACCESS=y
CONFIG_DISK_DRIVER_SDMMC=y

CONFIG_FILE_SYSTEM=y
CONFIG_FAT_FILESYSTEM_ELM=y
CONFIG_FS_FATFS_LFN=y
CONFIG_FS_FATFS_LFN_MODE_HEAP=y
CONFIG_FS_FATFS_MAX_LFN=255
CONFIG_FS_FATFS_CODEPAGE=437
CONFIG_FS_FATFS_MOUNT_MKFS=n

# =============================================================================
# Network Control Service (netctl - ported from Helios runtime)
# =============================================================================
# netctl Kconfig auto-selects: NETWORKING, NET_IPV4, NET_TCP, NET_UDP,
# NET_SOCKETS, NET_MGMT, NET_MGMT_EVENT, NET_MGMT_EVENT_INFO,
# DNS_RESOLVER, NET_L2_ETHERNET, NET_DHCPV4, WIFI_NM,
# ESP32_WIFI_STA_AUTO_DHCPV4

CONFIG_ICLE_NETCTL=y
CONFIG_ICLE_NETCTL_WIFI=y
CONFIG_ICLE_NETCTL_LOG_LEVEL=3

# WiFi hardware
CONFIG_WIFI=y
CONFIG_WIFI_LOG_LEVEL_INF=y

# WiFi scan support
CONFIG_WIFI_MGMT_RAW_SCAN_RESULTS=y
CONFIG_WIFI_MGMT_RAW_SCAN_RESULTS_ONLY=n

# Default WiFi credentials for testing (ICLE_HERE network)
CONFIG_ICLE_WIFI_SSID="ICLE_HERE"
CONFIG_ICLE_WIFI_PSK="icle4testing"

# Network buffers
CONFIG_NET_TX_STACK_SIZE=2048
CONFIG_NET_RX_STACK_SIZE=2048
CONFIG_NET_PKT_RX_COUNT=16
CONFIG_NET_PKT_TX_COUNT=16
CONFIG_NET_BUF_RX_COUNT=32
CONFIG_NET_BUF_TX_COUNT=32
CONFIG_NET_MAX_CONTEXTS=10
CONFIG_NET_IF_MAX_IPV4_COUNT=1

# Network management stack (increased for WiFi events)
CONFIG_NET_MGMT_EVENT_STACK_SIZE=2048

# =============================================================================
# BSD Sockets for HTTP Client
# =============================================================================

CONFIG_POSIX_API=y
CONFIG_NET_SOCKETS_POLL_MAX=8

# =============================================================================
# HTTP Client
# =============================================================================

CONFIG_HTTP_CLIENT=y

# =============================================================================
# Entropy and Random (needed for netctl jitter)
# =============================================================================

CONFIG_ENTROPY_GENERATOR=y
CONFIG_TEST_RANDOM_GENERATOR=n

# =============================================================================
# Power Management
# =============================================================================

CONFIG_PM=y
CONFIG_PM_DEVICE=y
CONFIG_POWEROFF=y

# =============================================================================
# ZMS and Settings for Configuration Storage
# =============================================================================

# Flash and flash map support
CONFIG_FLASH=y
CONFIG_FLASH_PAGE_LAYOUT=y
CONFIG_FLASH_MAP=y
CONFIG_MPU_ALLOW_FLASH_WRITE=y

# ZMS (Zephyr Memory Storage) - replaces NVS in Zephyr 4.0+
CONFIG_ZMS=y
CONFIG_ZMS_LOG_LEVEL_WRN=y

# NVS fallback for older Zephyr versions
CONFIG_NVS=y
CONFIG_NVS_LOG_LEVEL_WRN=y

# Settings subsystem for configuration persistence
CONFIG_SETTINGS=y
CONFIG_SETTINGS_NVS=y
CONFIG_SETTINGS_RUNTIME=y

# =============================================================================
# Date/Time Support
# =============================================================================

CONFIG_SNTP=y

# =============================================================================
# Debug Options (disable in production)
# =============================================================================

CONFIG_DEBUG=y
CONFIG_DEBUG_INFO=y
CONFIG_ASSERT=y
CONFIG_ASSERT_VERBOSE=y

# Stack overflow detection
CONFIG_STACK_SENTINEL=y

# =============================================================================
# Network Shell Commands (debugging)
# =============================================================================

CONFIG_NET_SHELL=y

# =============================================================================
# Memory Configuration
# =============================================================================

# Increase ISR stack for WiFi interrupts
CONFIG_ISR_STACK_SIZE=2048

# System memory pool
CONFIG_KERNEL_MEM_POOL=y
```

## include/icle_app.h
```c
/*
 * SPDX-License-Identifier: Apache-2.0
 * ICLE Application State Machine
 *
 * Main application controller managing operating modes and state transitions.
 * Uses programmatic Zephyr APIs (no K_* macros).
 */

#ifndef ICLE_APP_H_
#define ICLE_APP_H_

#include <zephyr/kernel.h>
#include <stdint.h>
#include <stdbool.h>

#ifdef __cplusplus
extern "C" {
#endif

/**
 * @brief Application operating states
 */
enum icle_app_state {
	ICLE_STATE_BOOT,          /* Initial boot, hardware init */
	ICLE_STATE_BOOT_DECIDE,   /* Waiting for button to determine mode */
	ICLE_STATE_CONFIG,        /* Configuration mode (WiFi STA active) */
	ICLE_STATE_LOGGER,        /* Active logging mode */
	ICLE_STATE_SHUTDOWN,      /* Graceful shutdown in progress */
	ICLE_STATE_DEEP_SLEEP,    /* Entering deep sleep */
	ICLE_STATE_ERROR,         /* Critical error state */
};

/**
 * @brief Application events (used with k_event)
 */
enum icle_app_event {
	ICLE_EVENT_BUTTON_SHORT     = BIT(0),  /* Short button press */
	ICLE_EVENT_BUTTON_LONG      = BIT(1),  /* Long button press (>=2s) */
	ICLE_EVENT_BUTTON_DOUBLE    = BIT(2),  /* Double press */
	ICLE_EVENT_BUTTON_HELD_3S   = BIT(3),  /* Button held 3+ seconds */
	ICLE_EVENT_WIFI_CONNECTED   = BIT(4),  /* WiFi connection established */
	ICLE_EVENT_WIFI_DISCONNECTED = BIT(5), /* WiFi disconnected */
	ICLE_EVENT_CONFIG_TIMEOUT   = BIT(6),  /* Config mode timeout */
	ICLE_EVENT_CRITICAL_ERROR   = BIT(7),  /* Critical error occurred */
	ICLE_EVENT_SHUTDOWN_REQUEST = BIT(8),  /* Shutdown requested */
	ICLE_EVENT_SYNC_COMPLETE    = BIT(9),  /* HTTP sync completed */
};

/**
 * @brief Application configuration (loaded from NVS)
 */
struct icle_app_config {
	char wifi_ssid[33];
	char wifi_psk[65];
	char device_id[32];
	char sync_url[128];
	uint32_t sample_interval_ms;
	uint32_t sync_interval_ms;
	uint8_t log_format;
	uint8_t flags;
};

/**
 * @brief Application runtime context
 */
struct icle_app_ctx {
	enum icle_app_state state;
	enum icle_app_state prev_state;
	struct icle_app_config config;
	uint32_t boot_count;
	uint32_t state_enter_time;
	bool wifi_connected;
	bool storage_ready;
};

/**
 * @brief Initialize the application state machine
 *
 * Creates required threads, queues, and synchronization primitives.
 * Does NOT use K_THREAD_DEFINE or similar macros.
 *
 * @return 0 on success, negative errno on failure
 */
int icle_app_init(void);

/**
 * @brief Start the application state machine
 *
 * Begins state machine execution. Call after all modules initialized.
 *
 * @return 0 on success, negative errno on failure
 */
int icle_app_start(void);

/**
 * @brief Get current application state
 *
 * @return Current state
 */
enum icle_app_state icle_app_get_state(void);

/**
 * @brief Get application context (read-only)
 *
 * @return Pointer to application context
 */
const struct icle_app_ctx *icle_app_get_ctx(void);

/**
 * @brief Post an event to the application state machine
 *
 * Thread-safe event posting.
 *
 * @param event Event flags to post (can be ORed together)
 */
void icle_app_post_event(uint32_t event);

/**
 * @brief Request mode change
 *
 * Requests transition to a new operating mode. The state machine
 * will validate and execute the transition if allowed.
 *
 * @param target_state Requested target state
 * @return 0 if request accepted, -EINVAL if invalid transition
 */
int icle_app_request_mode(enum icle_app_state target_state);

/**
 * @brief Request shutdown
 *
 * Initiates graceful shutdown sequence:
 * 1. Flush pending logs
 * 2. Complete/cancel HTTP sync
 * 3. Disconnect WiFi
 * 4. Enter deep sleep
 *
 * @param enter_deep_sleep true to enter deep sleep, false to halt
 * @return 0 on success
 */
int icle_app_shutdown(bool enter_deep_sleep);

/**
 * @brief Load configuration from NVS
 *
 * @param config Pointer to store loaded configuration
 * @return 0 on success, -ENOENT if not found, negative errno on error
 */
int icle_app_load_config(struct icle_app_config *config);

/**
 * @brief Save configuration to NVS
 *
 * @param config Configuration to save
 * @return 0 on success, negative errno on failure
 */
int icle_app_save_config(const struct icle_app_config *config);

/**
 * @brief Get default configuration
 *
 * @param config Pointer to store default configuration
 */
void icle_app_default_config(struct icle_app_config *config);

/**
 * @brief Get state name string
 *
 * @param state State to get name for
 * @return State name string
 */
const char *icle_app_state_name(enum icle_app_state state);

#ifdef __cplusplus
}
#endif

#endif /* ICLE_APP_H_ */
```

## include/icle_button.h
```c
/*
 * SPDX-License-Identifier: Apache-2.0
 * ICLE Button Handler
 *
 * Handles button input with debouncing and pattern detection.
 * Supports: short press, long press, double press, held detection.
 * Uses programmatic Zephyr APIs (no K_* macros).
 */

#ifndef ICLE_BUTTON_H_
#define ICLE_BUTTON_H_

#include <zephyr/kernel.h>
#include <stdint.h>
#include <stdbool.h>

#ifdef __cplusplus
extern "C" {
#endif

/**
 * @brief Button event types
 */
enum icle_button_event {
	ICLE_BTN_EVENT_NONE = 0,
	ICLE_BTN_EVENT_PRESSED,       /* Button pressed (debounced) */
	ICLE_BTN_EVENT_RELEASED,      /* Button released */
	ICLE_BTN_EVENT_SHORT_PRESS,   /* Press < long_threshold */
	ICLE_BTN_EVENT_LONG_PRESS,    /* Press >= long_threshold */
	ICLE_BTN_EVENT_DOUBLE_PRESS,  /* Two presses within double_window */
	ICLE_BTN_EVENT_HELD,          /* Button held for held_threshold */
};

/**
 * @brief Button callback type
 *
 * @param event The button event
 * @param hold_time_ms How long button was held (for press events)
 * @param user_data User-provided context
 */
typedef void (*icle_button_callback_t)(enum icle_button_event event,
				       uint32_t hold_time_ms,
				       void *user_data);

/**
 * @brief Button timing configuration
 */
struct icle_button_config {
	uint32_t debounce_ms;       /* Debounce time (default: 20ms) */
	uint32_t long_press_ms;     /* Long press threshold (default: 2000ms) */
	uint32_t double_press_ms;   /* Double press window (default: 300ms) */
	uint32_t held_threshold_ms; /* Held event threshold (default: 3000ms) */
};

/**
 * @brief Initialize button handler
 *
 * Configures GPIO interrupt and creates work queue items programmatically.
 * Does NOT use K_WORK_DEFINE or similar macros.
 *
 * @return 0 on success, negative errno on failure
 */
int icle_button_init(void);

/**
 * @brief Deinitialize button handler
 *
 * Disables GPIO interrupt and releases resources.
 *
 * @return 0 on success, negative errno on failure
 */
int icle_button_deinit(void);

/**
 * @brief Set button timing configuration
 *
 * @param config Timing configuration (NULL for defaults)
 * @return 0 on success, -EINVAL if values invalid
 */
int icle_button_set_config(const struct icle_button_config *config);

/**
 * @brief Get current button configuration
 *
 * @param config Pointer to store configuration
 * @return 0 on success
 */
int icle_button_get_config(struct icle_button_config *config);

/**
 * @brief Register button event callback
 *
 * Multiple callbacks can be registered.
 *
 * @param callback Callback function
 * @param user_data User context passed to callback
 * @return 0 on success, -ENOMEM if too many callbacks
 */
int icle_button_register_callback(icle_button_callback_t callback,
				  void *user_data);

/**
 * @brief Unregister button event callback
 *
 * @param callback Callback to remove
 */
void icle_button_unregister_callback(icle_button_callback_t callback);

/**
 * @brief Check if button is currently pressed
 *
 * @return true if button is pressed
 */
bool icle_button_is_pressed(void);

/**
 * @brief Get button press duration
 *
 * @return Duration in ms if pressed, 0 if not pressed
 */
uint32_t icle_button_get_hold_time(void);

/**
 * @brief Wait for button event
 *
 * Blocks until specified event occurs or timeout.
 *
 * @param event_mask Events to wait for (ORed together)
 * @param timeout_ms Timeout in ms, K_FOREVER for indefinite
 * @return Event that occurred, or ICLE_BTN_EVENT_NONE on timeout
 */
enum icle_button_event icle_button_wait_event(uint32_t event_mask,
					      uint32_t timeout_ms);

/**
 * @brief Enable/disable button handling
 *
 * When disabled, GPIO interrupts are still processed but no events
 * are generated. Useful during critical operations.
 *
 * @param enable true to enable event generation
 */
void icle_button_set_enabled(bool enable);

/**
 * @brief Check if button handling is enabled
 *
 * @return true if events are being generated
 */
bool icle_button_is_enabled(void);

/**
 * @brief Configure button as wake source
 *
 * Sets up button GPIO to wake from deep sleep.
 *
 * @param enable true to enable wake capability
 * @return 0 on success, negative errno on failure
 */
int icle_button_configure_wake(bool enable);

/**
 * @brief Get event name string
 *
 * @param event Button event
 * @return Event name string
 */
const char *icle_button_event_name(enum icle_button_event event);

#ifdef __cplusplus
}
#endif

#endif /* ICLE_BUTTON_H_ */
```

## include/icle_http.h
```c
/*
 * SPDX-License-Identifier: Apache-2.0
 * ICLE HTTP Client
 *
 * HTTP client for syncing logs to Concord backend.
 * Uses programmatic Zephyr APIs (no K_* macros).
 */

#ifndef ICLE_HTTP_H_
#define ICLE_HTTP_H_

#include <zephyr/kernel.h>
#include <stdint.h>
#include <stdbool.h>

#ifdef __cplusplus
extern "C" {
#endif

/**
 * @brief HTTP client state
 */
enum icle_http_state {
	ICLE_HTTP_STATE_IDLE,       /* No active request */
	ICLE_HTTP_STATE_CONNECTING, /* TCP connection in progress */
	ICLE_HTTP_STATE_SENDING,    /* Sending request */
	ICLE_HTTP_STATE_RECEIVING,  /* Receiving response */
	ICLE_HTTP_STATE_ERROR,      /* Request failed */
};

/**
 * @brief HTTP response status
 */
struct icle_http_response {
	int status_code;        /* HTTP status code (200, 404, etc) */
	size_t content_length;  /* Response body length */
	size_t body_received;   /* Bytes of body received so far */
	char content_type[64];  /* Content-Type header value */
};

/**
 * @brief Sync result for log file upload
 */
struct icle_sync_result {
	bool success;
	int http_status;
	uint32_t bytes_sent;
	uint32_t duration_ms;
	char error_msg[64];
};

/**
 * @brief Sync progress callback
 *
 * @param filename File being synced
 * @param bytes_sent Bytes sent so far
 * @param total_bytes Total file size
 * @param user_data User context
 */
typedef void (*icle_sync_progress_cb_t)(const char *filename,
					uint32_t bytes_sent,
					uint32_t total_bytes,
					void *user_data);

/**
 * @brief Sync complete callback
 *
 * @param filename File that was synced
 * @param result Sync result
 * @param user_data User context
 */
typedef void (*icle_sync_complete_cb_t)(const char *filename,
					const struct icle_sync_result *result,
					void *user_data);

/**
 * @brief Initialize HTTP client
 *
 * Creates internal resources programmatically.
 *
 * @return 0 on success, negative errno on failure
 */
int icle_http_init(void);

/**
 * @brief Deinitialize HTTP client
 *
 * Cancels pending requests and releases resources.
 *
 * @return 0 on success, negative errno on failure
 */
int icle_http_deinit(void);

/**
 * @brief Set base URL for API requests
 *
 * @param base_url Base URL (e.g., "https://api.concord.local")
 * @return 0 on success, -EINVAL if URL invalid
 */
int icle_http_set_base_url(const char *base_url);

/**
 * @brief Set device ID for API authentication
 *
 * @param device_id Device identifier
 * @return 0 on success, -EINVAL if ID invalid
 */
int icle_http_set_device_id(const char *device_id);

/**
 * @brief Set API key/token for authentication
 *
 * @param api_key API key or bearer token
 * @return 0 on success, negative errno on failure
 */
int icle_http_set_api_key(const char *api_key);

/**
 * @brief Sync single log file to backend
 *
 * Uploads file via HTTP POST to configured endpoint.
 * Blocking call - returns when complete or error.
 *
 * @param filename Log file path on SD card
 * @param result Pointer to store result (can be NULL)
 * @return 0 on success, negative errno on failure
 */
int icle_http_sync_file(const char *filename, struct icle_sync_result *result);

/**
 * @brief Start async log file sync
 *
 * Non-blocking file upload. Use callbacks for progress/completion.
 *
 * @param filename Log file path
 * @return 0 if started, negative errno on failure
 */
int icle_http_sync_file_async(const char *filename);

/**
 * @brief Cancel pending sync operation
 *
 * @return 0 on success, -ENOENT if no sync in progress
 */
int icle_http_cancel_sync(void);

/**
 * @brief Check if sync is in progress
 *
 * @return true if sync operation active
 */
bool icle_http_is_syncing(void);

/**
 * @brief Wait for sync to complete
 *
 * @param timeout_ms Timeout in ms, K_FOREVER for indefinite
 * @return 0 on success, -ETIMEDOUT on timeout
 */
int icle_http_wait_sync(uint32_t timeout_ms);

/**
 * @brief Get HTTP client state
 *
 * @return Current state
 */
enum icle_http_state icle_http_get_state(void);

/**
 * @brief Register progress callback
 *
 * @param callback Progress callback
 * @param user_data User context
 */
void icle_http_set_progress_callback(icle_sync_progress_cb_t callback,
				     void *user_data);

/**
 * @brief Register completion callback
 *
 * @param callback Completion callback
 * @param user_data User context
 */
void icle_http_set_complete_callback(icle_sync_complete_cb_t callback,
				     void *user_data);

/**
 * @brief Perform health check ping to backend
 *
 * @param timeout_ms Request timeout
 * @return 0 if backend reachable, negative errno on failure
 */
int icle_http_ping(uint32_t timeout_ms);

/**
 * @brief Register device with backend
 *
 * POST device info to registration endpoint.
 *
 * @param device_id Device identifier
 * @param firmware_version Firmware version string
 * @return 0 on success, HTTP status if error response, negative errno on failure
 */
int icle_http_register_device(const char *device_id, const char *firmware_version);

/**
 * @brief Get pending configuration from backend
 *
 * Checks if backend has new configuration for this device.
 *
 * @param buffer Buffer to store config JSON
 * @param buffer_size Buffer size
 * @return Bytes received, 0 if no new config, negative errno on error
 */
int icle_http_get_config(char *buffer, size_t buffer_size);

/**
 * @brief Set connection timeout
 *
 * @param timeout_ms Connection timeout in ms
 */
void icle_http_set_timeout(uint32_t timeout_ms);

/**
 * @brief Set retry configuration
 *
 * @param max_retries Maximum retry attempts (0 = no retry)
 * @param backoff_ms Initial backoff between retries
 */
void icle_http_set_retry_config(uint8_t max_retries, uint32_t backoff_ms);

/**
 * @brief Get state name string
 *
 * @param state HTTP state
 * @return State name string
 */
const char *icle_http_state_name(enum icle_http_state state);

#ifdef __cplusplus
}
#endif

#endif /* ICLE_HTTP_H_ */
```

## include/icle_log.h
```c
/*
 * SPDX-License-Identifier: Apache-2.0
 * ICLE Log Manager
 *
 * Manages power measurement sampling, log entry formatting, and queuing.
 * Uses programmatic Zephyr APIs (no K_* macros).
 */

#ifndef ICLE_LOG_H_
#define ICLE_LOG_H_

#include <zephyr/kernel.h>
#include <stdint.h>
#include <stdbool.h>

#ifdef __cplusplus
extern "C" {
#endif

/**
 * @brief Log entry status flags
 */
enum icle_log_flags {
	ICLE_LOG_FLAG_NONE        = 0,
	ICLE_LOG_FLAG_OVERFLOW    = BIT(0),  /* Sample queue overflow */
	ICLE_LOG_FLAG_SENSOR_ERR  = BIT(1),  /* Sensor read error */
	ICLE_LOG_FLAG_SYNC_POINT  = BIT(2),  /* Sync checkpoint */
	ICLE_LOG_FLAG_MODE_CHANGE = BIT(3),  /* Operating mode changed */
};

/**
 * @brief Single log entry (power measurement sample)
 */
struct icle_log_entry {
	uint32_t timestamp_ms;   /* Uptime at sample time */
	uint32_t rtc_time;       /* RTC epoch if available, 0 otherwise */
	int32_t voltage_uv;      /* Bus voltage in microvolts */
	int32_t current_ua;      /* Current in microamps */
	int32_t power_uw;        /* Power in microwatts */
	uint8_t flags;           /* Status flags */
	uint8_t reserved[3];     /* Alignment padding */
};

/**
 * @brief Log manager statistics
 */
struct icle_log_stats {
	uint32_t samples_taken;
	uint32_t samples_written;
	uint32_t samples_dropped;
	uint32_t queue_depth;
	uint32_t max_queue_depth;
	uint32_t write_errors;
	bool sampling_active;
};

/**
 * @brief Sample callback type
 *
 * Called for each sample if registered. Can be used for real-time display.
 *
 * @param entry The sampled log entry
 * @param user_data User-provided context
 */
typedef void (*icle_log_sample_cb_t)(const struct icle_log_entry *entry,
				     void *user_data);

/**
 * @brief Initialize log manager
 *
 * Creates sample queue and threads programmatically.
 * Does NOT use K_QUEUE_DEFINE or K_THREAD_DEFINE.
 *
 * @return 0 on success, negative errno on failure
 */
int icle_log_init(void);

/**
 * @brief Deinitialize log manager
 *
 * Stops sampling, flushes queue, releases resources.
 *
 * @return 0 on success, negative errno on failure
 */
int icle_log_deinit(void);

/**
 * @brief Start power sampling
 *
 * Begins periodic INA209 sampling at specified interval.
 * Samples are queued for writing to storage.
 *
 * @param interval_ms Sample interval in milliseconds
 * @return 0 on success, negative errno on failure
 */
int icle_log_start_sampling(uint32_t interval_ms);

/**
 * @brief Stop power sampling
 *
 * Stops the sampling thread. Queue continues to drain.
 *
 * @return 0 on success, negative errno on failure
 */
int icle_log_stop_sampling(void);

/**
 * @brief Check if sampling is active
 *
 * @return true if sampling thread is running
 */
bool icle_log_is_sampling(void);

/**
 * @brief Set sample interval
 *
 * Can be called while sampling is active.
 *
 * @param interval_ms New sample interval in milliseconds
 * @return 0 on success, -EINVAL if interval invalid
 */
int icle_log_set_interval(uint32_t interval_ms);

/**
 * @brief Get current sample interval
 *
 * @return Current interval in ms, or 0 if not sampling
 */
uint32_t icle_log_get_interval(void);

/**
 * @brief Take single sample immediately
 *
 * Takes a sample outside the normal sampling interval.
 *
 * @param entry Pointer to store the sample (can be NULL)
 * @return 0 on success, negative errno on failure
 */
int icle_log_take_sample(struct icle_log_entry *entry);

/**
 * @brief Get next entry from queue (for writer thread)
 *
 * Blocks until entry available or timeout.
 *
 * @param entry Pointer to store entry
 * @param timeout_ms Timeout in ms, K_FOREVER for indefinite
 * @return 0 on success, -ETIMEDOUT on timeout, negative errno on error
 */
int icle_log_queue_get(struct icle_log_entry *entry, uint32_t timeout_ms);

/**
 * @brief Get queue depth
 *
 * @return Number of entries currently in queue
 */
uint32_t icle_log_queue_depth(void);

/**
 * @brief Flush queue to storage
 *
 * Blocks until all queued entries written.
 *
 * @param timeout_ms Maximum time to wait
 * @return 0 on success, -ETIMEDOUT if not all flushed
 */
int icle_log_flush(uint32_t timeout_ms);

/**
 * @brief Get log statistics
 *
 * @param stats Pointer to store statistics
 * @return 0 on success
 */
int icle_log_get_stats(struct icle_log_stats *stats);

/**
 * @brief Reset statistics counters
 */
void icle_log_reset_stats(void);

/**
 * @brief Register sample callback
 *
 * @param callback Callback function
 * @param user_data User context
 * @return 0 on success, -ENOMEM if too many callbacks
 */
int icle_log_register_callback(icle_log_sample_cb_t callback, void *user_data);

/**
 * @brief Unregister sample callback
 *
 * @param callback Callback to remove
 */
void icle_log_unregister_callback(icle_log_sample_cb_t callback);

/**
 * @brief Format entry as CSV string
 *
 * @param entry Entry to format
 * @param buffer Output buffer
 * @param buffer_size Buffer size
 * @return Length of formatted string, or negative errno on error
 */
int icle_log_format_csv(const struct icle_log_entry *entry, char *buffer,
			size_t buffer_size);

/**
 * @brief Get CSV header string
 *
 * @param buffer Output buffer
 * @param buffer_size Buffer size
 * @return Length of header string
 */
int icle_log_csv_header(char *buffer, size_t buffer_size);

#ifdef __cplusplus
}
#endif

#endif /* ICLE_LOG_H_ */
```

## include/icle_power_monitor.h
```c
/*
 * SPDX-License-Identifier: Apache-2.0
 * ICLE Power Management
 *
 * Manages device power states including deep sleep and wake sources.
 * Separate from icle_power.h which handles INA209 power monitoring.
 * Uses programmatic Zephyr APIs (no K_* macros).
 */

#ifndef ICLE_POWER_MONITOR_H_
#define ICLE_POWER_MONITOR_H_

#include <zephyr/kernel.h>
#include <stdint.h>
#include <stdbool.h>

#ifdef __cplusplus
extern "C" {
#endif

/**
 * @brief Wake source identification
 */
enum icle_wake_source {
	ICLE_WAKE_UNKNOWN = 0,
	ICLE_WAKE_BUTTON,       /* GPIO button press */
	ICLE_WAKE_TIMER,        /* RTC timer */
	ICLE_WAKE_RESET,        /* Power-on or reset */
};

/**
 * @brief RTC-preserved state across deep sleep
 */
struct icle_rtc_state {
	uint32_t magic;             /* Validation magic number */
	uint8_t last_mode;          /* Last operating mode before sleep */
	uint32_t boot_count;        /* Number of boots/wakes */
	uint32_t last_sync_time;    /* Last successful sync timestamp */
	uint32_t pending_samples;   /* Samples not yet synced */
	uint32_t sleep_duration_ms; /* Requested sleep duration */
};

#define ICLE_RTC_STATE_MAGIC 0x49434C45  /* "ICLE" */

/**
 * @brief Initialize power management subsystem
 *
 * Configures wake sources and loads RTC state if valid.
 *
 * @return 0 on success, negative errno on failure
 */
int icle_pm_init(void);

/**
 * @brief Get the wake source for current boot
 *
 * @return Wake source that caused current boot
 */
enum icle_wake_source icle_pm_get_wake_source(void);

/**
 * @brief Get RTC-preserved state
 *
 * @param state Pointer to store RTC state
 * @return 0 on success, -EINVAL if state invalid/corrupt
 */
int icle_pm_get_rtc_state(struct icle_rtc_state *state);

/**
 * @brief Save state to RTC memory before sleep
 *
 * @param state State to preserve
 * @return 0 on success, negative errno on failure
 */
int icle_pm_save_rtc_state(const struct icle_rtc_state *state);

/**
 * @brief Configure wake sources
 *
 * @param gpio_wake Enable GPIO button wake
 * @param timer_wake Enable RTC timer wake
 * @param timer_ms Timer interval in ms (if timer_wake enabled)
 * @return 0 on success, negative errno on failure
 */
int icle_pm_configure_wake(bool gpio_wake, bool timer_wake, uint32_t timer_ms);

/**
 * @brief Enter deep sleep
 *
 * This function does not return on success - device enters deep sleep.
 * Caller must ensure all pending operations are complete before calling.
 *
 * @return Negative errno on failure (only returns on error)
 */
int icle_pm_enter_deep_sleep(void);

/**
 * @brief Request light sleep for power saving
 *
 * Enters light sleep while waiting for events. WiFi stays connected
 * in light sleep mode (automatic modem sleep).
 *
 * @param timeout_ms Maximum sleep duration, K_FOREVER for indefinite
 * @return 0 on normal wake, -ETIMEDOUT on timeout
 */
int icle_pm_light_sleep(uint32_t timeout_ms);

/**
 * @brief Get boot count
 *
 * @return Number of boots since RTC state was last cleared
 */
uint32_t icle_pm_get_boot_count(void);

/**
 * @brief Get uptime in milliseconds
 *
 * @return Uptime since boot in ms
 */
uint32_t icle_pm_get_uptime_ms(void);

/**
 * @brief Get wake source name string
 *
 * @param source Wake source
 * @return Wake source name string
 */
const char *icle_pm_wake_source_name(enum icle_wake_source source);

/**
 * @brief Start idle timeout timer
 *
 * When the timer expires, the system will request a return to deep sleep.
 * Use icle_pm_reset_idle_timer() on activity to prevent sleep.
 *
 * @param timeout_ms Timeout in milliseconds
 * @return 0 on success, negative errno on failure
 */
int icle_pm_start_idle_timer(uint32_t timeout_ms);

/**
 * @brief Reset idle timeout timer
 *
 * Call this on user activity to prevent automatic sleep.
 *
 * @return 0 on success, negative errno on failure
 */
int icle_pm_reset_idle_timer(void);

/**
 * @brief Stop idle timeout timer
 *
 * @return 0 on success, negative errno on failure
 */
int icle_pm_stop_idle_timer(void);

/**
 * @brief Set last operating mode in RTC state
 *
 * @param mode Operating mode to save
 * @return 0 on success, negative errno on failure
 */
int icle_pm_set_last_mode(uint8_t mode);

/**
 * @brief Get last operating mode from RTC state
 *
 * @return Last mode, or 0 if not available
 */
uint8_t icle_pm_get_last_mode(void);

/**
 * @brief Set pending samples count in RTC state
 *
 * @param count Number of pending samples
 * @return 0 on success, negative errno on failure
 */
int icle_pm_set_pending_samples(uint32_t count);

/**
 * @brief Get pending samples count from RTC state
 *
 * @return Pending sample count, or 0 if not available
 */
uint32_t icle_pm_get_pending_samples(void);

/**
 * @brief Set last sync time in RTC state
 *
 * @param time Sync timestamp (e.g., uptime or epoch)
 * @return 0 on success, negative errno on failure
 */
int icle_pm_set_last_sync_time(uint32_t time);

/**
 * @brief Get last sync time from RTC state
 *
 * @return Last sync time, or 0 if not available
 */
uint32_t icle_pm_get_last_sync_time(void);

/**
 * @brief Prepare for deep sleep (graceful shutdown helper)
 *
 * Saves state to RTC memory and configures wake sources.
 * Call this before icle_pm_enter_deep_sleep().
 *
 * @param mode Current operating mode to save
 * @param enable_gpio_wake Enable GPIO button wake
 * @param enable_timer_wake Enable timer wake
 * @param timer_ms Timer interval if timer wake enabled
 * @return 0 on success, negative errno on failure
 */
int icle_pm_prepare_deep_sleep(uint8_t mode, bool enable_gpio_wake,
			       bool enable_timer_wake, uint32_t timer_ms);

#ifdef __cplusplus
}
#endif

#endif /* ICLE_POWER_MONITOR_H_ */
```

## include/icle_storage.h
```c
/*
 * SPDX-License-Identifier: Apache-2.0
 * ICLE SD Card Storage Manager
 *
 * Manages SD card mounting, log file operations, and rotation.
 * Uses programmatic Zephyr APIs (no K_* macros).
 */

#ifndef ICLE_STORAGE_H_
#define ICLE_STORAGE_H_

#include <zephyr/kernel.h>
#include <zephyr/fs/fs.h>
#include <stdint.h>
#include <stdbool.h>

#ifdef __cplusplus
extern "C" {
#endif

/**
 * @brief Storage state
 */
enum icle_storage_state {
	ICLE_STORAGE_UNMOUNTED,  /* SD card not mounted */
	ICLE_STORAGE_MOUNTED,    /* SD card mounted and ready */
	ICLE_STORAGE_ERROR,      /* Mount or I/O error */
	ICLE_STORAGE_FULL,       /* SD card full (< threshold) */
};

/**
 * @brief Log file format
 */
enum icle_log_format {
	ICLE_LOG_FORMAT_BINARY = 0,  /* Compact binary format */
	ICLE_LOG_FORMAT_CSV = 1,     /* Human-readable CSV */
};

/**
 * @brief Storage statistics
 */
struct icle_storage_stats {
	enum icle_storage_state state;
	uint64_t total_bytes;
	uint64_t free_bytes;
	uint32_t log_file_count;
	uint32_t pending_sync_count;
	char current_log_file[64];
};

/**
 * @brief File entry for enumeration
 */
struct icle_file_entry {
	char name[64];
	uint32_t size;
	uint32_t timestamp;
	bool synced;
};

/**
 * @brief Initialize storage subsystem
 *
 * Initializes SPI interface and mounts SD card.
 * Creates internal mutex programmatically.
 *
 * @return 0 on success, negative errno on failure
 */
int icle_storage_init(void);

/**
 * @brief Deinitialize storage subsystem
 *
 * Unmounts SD card and releases resources.
 *
 * @return 0 on success, negative errno on failure
 */
int icle_storage_deinit(void);

/**
 * @brief Mount SD card
 *
 * @return 0 on success, negative errno on failure
 */
int icle_storage_mount(void);

/**
 * @brief Unmount SD card
 *
 * Flushes pending writes before unmounting.
 *
 * @return 0 on success, negative errno on failure
 */
int icle_storage_unmount(void);

/**
 * @brief Check if storage is ready
 *
 * @return true if mounted and ready for I/O
 */
bool icle_storage_is_ready(void);

/**
 * @brief Get storage state
 *
 * @return Current storage state
 */
enum icle_storage_state icle_storage_get_state(void);

/**
 * @brief Get storage statistics
 *
 * @param stats Pointer to store statistics
 * @return 0 on success, negative errno on failure
 */
int icle_storage_get_stats(struct icle_storage_stats *stats);

/**
 * @brief Create new log file
 *
 * Creates a new log file with timestamp-based name.
 * Closes previous log file if open.
 *
 * @param format Log file format (binary or CSV)
 * @return 0 on success, negative errno on failure
 */
int icle_storage_create_log(enum icle_log_format format);

/**
 * @brief Write data to current log file
 *
 * @param data Pointer to data buffer
 * @param len Length of data in bytes
 * @return Number of bytes written, or negative errno on failure
 */
int icle_storage_write_log(const void *data, size_t len);

/**
 * @brief Flush log file buffers to SD card
 *
 * @return 0 on success, negative errno on failure
 */
int icle_storage_flush_log(void);

/**
 * @brief Close current log file
 *
 * @return 0 on success, negative errno on failure
 */
int icle_storage_close_log(void);

/**
 * @brief Check if log rotation is needed
 *
 * @param max_size_bytes Maximum log file size
 * @return true if current log exceeds max size
 */
bool icle_storage_needs_rotation(uint32_t max_size_bytes);

/**
 * @brief Rotate log file
 *
 * Closes current log and creates new one.
 *
 * @param format Format for new log file
 * @return 0 on success, negative errno on failure
 */
int icle_storage_rotate_log(enum icle_log_format format);

/**
 * @brief Get list of log files pending sync
 *
 * @param entries Array to store file entries
 * @param max_entries Maximum entries to return
 * @return Number of entries found, or negative errno on failure
 */
int icle_storage_get_pending_files(struct icle_file_entry *entries,
				   size_t max_entries);

/**
 * @brief Mark file as synced
 *
 * @param filename File to mark as synced
 * @return 0 on success, negative errno on failure
 */
int icle_storage_mark_synced(const char *filename);

/**
 * @brief Read file contents
 *
 * @param filename File to read
 * @param buffer Buffer to store contents
 * @param buffer_size Size of buffer
 * @param offset Offset in file to start reading
 * @return Bytes read, or negative errno on failure
 */
int icle_storage_read_file(const char *filename, void *buffer,
			   size_t buffer_size, size_t offset);

/**
 * @brief Delete file
 *
 * @param filename File to delete
 * @return 0 on success, negative errno on failure
 */
int icle_storage_delete_file(const char *filename);

/**
 * @brief Clean up old files when storage is low
 *
 * Deletes oldest synced files until free space > threshold.
 *
 * @param min_free_percent Minimum free space percentage
 * @return Number of files deleted, or negative errno on failure
 */
int icle_storage_cleanup(uint8_t min_free_percent);

/**
 * @brief Get storage state name string
 *
 * @param state Storage state
 * @return State name string
 */
const char *icle_storage_state_name(enum icle_storage_state state);

#ifdef __cplusplus
}
#endif

#endif /* ICLE_STORAGE_H_ */
```

## include/icle_wifi.h
```c
/*
 * SPDX-License-Identifier: Apache-2.0
 * ICLE WiFi Station Manager
 *
 * Manages WiFi STA connection, reconnection, and status.
 * Uses programmatic Zephyr APIs (no K_* macros).
 */

#ifndef ICLE_WIFI_H_
#define ICLE_WIFI_H_

#include <zephyr/kernel.h>
#include <zephyr/net/net_if.h>
#include <stdint.h>
#include <stdbool.h>

#ifdef __cplusplus
extern "C" {
#endif

/**
 * @brief WiFi connection state
 */
enum icle_wifi_state {
	ICLE_WIFI_STATE_DISABLED,    /* WiFi not initialized */
	ICLE_WIFI_STATE_DISCONNECTED,/* Initialized but not connected */
	ICLE_WIFI_STATE_CONNECTING,  /* Connection in progress */
	ICLE_WIFI_STATE_CONNECTED,   /* Connected to AP */
	ICLE_WIFI_STATE_ERROR,       /* Error state */
};

/**
 * @brief WiFi connection callback type
 *
 * @param connected true if connected, false if disconnected
 * @param user_data User-provided context
 */
typedef void (*icle_wifi_callback_t)(bool connected, void *user_data);

/**
 * @brief WiFi connection parameters
 */
struct icle_wifi_params {
	const char *ssid;
	const char *psk;
	uint32_t timeout_ms;
	bool auto_reconnect;
};

/**
 * @brief WiFi status information
 */
struct icle_wifi_status {
	enum icle_wifi_state state;
	char ssid[33];
	int8_t rssi;
	uint8_t channel;
	uint8_t ip_addr[4];
	uint32_t connected_time_ms;
	uint32_t reconnect_count;
};

/**
 * @brief Initialize WiFi subsystem
 *
 * Must be called before any other WiFi functions.
 * Creates internal synchronization primitives programmatically.
 *
 * @return 0 on success, negative errno on failure
 */
int icle_wifi_init(void);

/**
 * @brief Deinitialize WiFi subsystem
 *
 * Disconnects and releases resources.
 *
 * @return 0 on success, negative errno on failure
 */
int icle_wifi_deinit(void);

/**
 * @brief Connect to WiFi network
 *
 * Initiates connection to specified network. Function returns
 * immediately; use callback or icle_wifi_wait_connected() to
 * wait for result.
 *
 * @param params Connection parameters
 * @return 0 if connection initiated, negative errno on failure
 */
int icle_wifi_connect(const struct icle_wifi_params *params);

/**
 * @brief Connect with SSID/PSK strings (convenience function)
 *
 * @param ssid Network SSID
 * @param psk Network password (NULL or empty for open network)
 * @param timeout_ms Connection timeout in ms
 * @return 0 if connection initiated, negative errno on failure
 */
int icle_wifi_connect_simple(const char *ssid, const char *psk,
			     uint32_t timeout_ms);

/**
 * @brief Wait for WiFi connection
 *
 * Blocks until connected or timeout.
 *
 * @param timeout_ms Maximum wait time, K_FOREVER for indefinite
 * @return 0 if connected, -ETIMEDOUT on timeout, other negative on error
 */
int icle_wifi_wait_connected(uint32_t timeout_ms);

/**
 * @brief Disconnect from WiFi network
 *
 * @return 0 on success, negative errno on failure
 */
int icle_wifi_disconnect(void);

/**
 * @brief Check if WiFi is connected
 *
 * @return true if connected to an AP
 */
bool icle_wifi_is_connected(void);

/**
 * @brief Get current WiFi state
 *
 * @return Current WiFi state
 */
enum icle_wifi_state icle_wifi_get_state(void);

/**
 * @brief Get WiFi status information
 *
 * @param status Pointer to store status info
 * @return 0 on success, negative errno on failure
 */
int icle_wifi_get_status(struct icle_wifi_status *status);

/**
 * @brief Register connection state callback
 *
 * @param callback Callback function
 * @param user_data User context passed to callback
 * @return 0 on success, -ENOMEM if too many callbacks
 */
int icle_wifi_register_callback(icle_wifi_callback_t callback, void *user_data);

/**
 * @brief Unregister connection state callback
 *
 * @param callback Callback to remove
 */
void icle_wifi_unregister_callback(icle_wifi_callback_t callback);

/**
 * @brief Enable/disable auto-reconnect
 *
 * @param enable true to enable auto-reconnect on disconnect
 */
void icle_wifi_set_auto_reconnect(bool enable);

/**
 * @brief Get network interface
 *
 * @return Pointer to WiFi network interface, NULL if not initialized
 */
struct net_if *icle_wifi_get_iface(void);

/**
 * @brief Get WiFi state name string
 *
 * @param state WiFi state
 * @return State name string
 */
const char *icle_wifi_state_name(enum icle_wifi_state state);

#ifdef __cplusplus
}
#endif

#endif /* ICLE_WIFI_H_ */
```

## src/main_new.c
```c
// SPDX-License-Identifier: Apache-2.0
/*
 * ICLE Zephyr Firmware - Main Entry Point
 *
 * CoreKinect In-Circuit Loop-back Equipment (ICLE) v1.0
 * ESP32-WROOM-32 based test fixture for DUT validation
 *
 * Boot sequence:
 * 1. Detect wake cause (cold boot, timer, button)
 * 2. Initialize PM (increments boot_count in RTC memory)
 * 3. Initialize all subsystems
 * 4. If timer wake: post TIMER_WAKE event for fast heartbeat path
 * 5. icle_app_run() — runs event loop on main thread, NEVER RETURNS
 *
 * Architecture: fully async event-driven, no blocking timeouts.
 * Only K_FOREVER and K_NO_WAIT are used for any blocking call.
 */

#include <zephyr/kernel.h>
#include <zephyr/logging/log.h>
LOG_MODULE_REGISTER(icle_main, CONFIG_LOG_DEFAULT_LEVEL);

#include "icle/version.h"
#include "icle/app.h"
#include "icle/config.h"

#include "app/events.h"
#include "hal/gpio.h"
#include "hal/power_monitor.h"
#include "hal/button.h"
#include "hal/storage.h"
#include "net/wifi.h"
#include "net/heartbeat.h"
#include "services/logger.h"
#include "services/ota.h"
#include "services/pm.h"

/**
 * @brief Print system banner on boot
 */
static void print_banner(enum icle_wake_source wake)
{
	const char *wake_str;

	switch (wake) {
	case ICLE_WAKE_TIMER:
		wake_str = "TIMER";
		break;
	case ICLE_WAKE_BUTTON:
		wake_str = "BUTTON";
		break;
	case ICLE_WAKE_RESET:
		wake_str = "RESET (cold boot)";
		break;
	default:
		wake_str = "UNKNOWN";
		break;
	}

	LOG_INF("=====================================");
	LOG_INF("  ICLE v%s - CoreKinect", ICLE_VERSION_STRING);
	LOG_INF("  In-Circuit Loop-back Equipment");
	LOG_INF("  Zephyr RTOS on ESP32-WROOM-32");
	LOG_INF("  Build: %s %s", ICLE_BUILD_DATE, ICLE_BUILD_TIME);
	LOG_INF("  Wake: %s  Boot#: %u", wake_str,
		icle_pm_get_boot_count());
	LOG_INF("=====================================");
}

/**
 * @brief Initialize all subsystems
 *
 * @return 0 on success, negative errno on critical failure
 */
static int init_subsystems(void)
{
	int ret;

	/* Initialize event system (must be first) */
	ret = icle_events_init();
	if (ret < 0) {
		LOG_ERR("Events init failed: %d", ret);
		return ret;
	}

	/* Initialize configuration manager */
	ret = icle_config_init();
	if (ret < 0)
		LOG_WRN("Config init failed: %d (using defaults)", ret);

	/* Initialize GPIO controls */
	ret = icle_gpio_init();
	if (ret < 0)
		LOG_WRN("GPIO init failed: %d (continuing)", ret);

	/* Initialize power monitor */
	ret = icle_power_init();
	if (ret < 0 && ret != -ENOTSUP)
		LOG_WRN("Power monitor init failed: %d (continuing)", ret);

	/* Initialize button handler */
	ret = icle_button_init();
	if (ret < 0) {
		LOG_ERR("Button init failed: %d", ret);
		return ret;
	}

	/* Initialize WiFi */
	ret = icle_wifi_init();
	if (ret < 0)
		LOG_WRN("WiFi init failed: %d (continuing)", ret);

	/* Initialize storage - non-critical, may fail if no SD card */
	ret = icle_storage_init();
	if (ret < 0)
		LOG_WRN("Storage init failed: %d (continuing)", ret);

	/* Initialize log manager */
	ret = icle_log_init();
	if (ret < 0)
		LOG_WRN("Log manager init failed: %d (continuing)", ret);

	/* Initialize heartbeat service */
	ret = icle_heartbeat_init();
	if (ret < 0)
		LOG_WRN("Heartbeat init failed: %d (continuing)", ret);

	/* Initialize OTA subsystem */
	ret = icle_ota_init();
	if (ret < 0)
		LOG_WRN("OTA init failed: %d (continuing)", ret);

	LOG_INF("All subsystems initialized");
	return 0;
}

/**
 * @brief Main application entry point
 *
 * After init, calls icle_app_run() which runs the event loop
 * on the main thread and NEVER RETURNS.
 */
int main(void)
{
	int ret;
	enum icle_wake_source wake;

	LOG_INF("*** ICLE main() starting ***");

	/*
	 * Step 1: Initialize PM and detect wake cause.
	 * This increments boot_count in RTC memory and
	 * reads esp_sleep_get_wakeup_cause() on ESP32.
	 */
	icle_pm_init();
	wake = icle_pm_detect_wake_cause();

	print_banner(wake);

	/*
	 * Step 2: Initialize all subsystems.
	 */
	ret = init_subsystems();
	if (ret < 0) {
		LOG_ERR("Critical subsystem init failed: %d", ret);
		/* Can't proceed - halt (LOG_MODE_IMMEDIATE flushes inline) */
		k_sleep(K_FOREVER);
		CODE_UNREACHABLE;
	}

	/*
	 * Step 3: Initialize application state machine.
	 */
	ret = icle_app_init();
	if (ret < 0) {
		LOG_ERR("App init failed: %d", ret);
		k_sleep(K_FOREVER);
		CODE_UNREACHABLE;
	}

	/*
	 * Step 4: If this is a timer wake from deep sleep,
	 * post the TIMER_WAKE event so the state machine
	 * can take the fast heartbeat path.
	 */
	if (wake == ICLE_WAKE_TIMER) {
		LOG_INF("Timer wake - posting TIMER_WAKE event");
		icle_events_post(ICLE_EVENT_TIMER_WAKE);
	}

	/*
	 * Step 5: Run the event loop on the main thread.
	 * This NEVER RETURNS. The main thread IS the app thread.
	 * All decisions happen in the event loop via k_event_wait(K_FOREVER).
	 */
	LOG_INF("Starting event loop (main thread, never returns)");
	icle_app_run();

	/* Never reaches here */
	CODE_UNREACHABLE;
	return 0;
}
```
