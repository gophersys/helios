## CMakeLists.txt
```
cmake_minimum_required(VERSION 3.20.0)

# Set Monorepo root
set(MONOREPO_ROOT "/workspaces/concord")
set(MONOREPO_ROOT ${MONOREPO_ROOT} CACHE INTERNAL "Monorepo root directory")

# Set the paths to the DTS and BOARD
set(DTS_ROOT ${MONOREPO_ROOT}/libs/zephyr/ck_boards/current)
set(BOARD_ROOT ${MONOREPO_ROOT}/libs/zephyr/ck_boards/current)
set(BOARD iwsck_a1/nrf54l15/cpuapp)

find_package(Zephyr REQUIRED HINTS $ENV{ZEPHYR_BASE})
project(iwsck_bringup)

if(CONFIG_SHELL)
  # Full bring-up shell with all peripherals
  target_sources(app PRIVATE
    src/main.c
    src/rs232.c
    src/led.c
    src/ble.c
    src/fuel.c
    src/power.c
    src/nfc.c
  )
elseif(CONFIG_NFC_T2T_NRFXLIB)
  # Headless BLE + NFC beacon
  target_sources(app PRIVATE
    src/main_beacon.c
  )
else()
  # Minimal no-shell (sleep only)
  target_sources(app PRIVATE
    src/main_noshell.c
  )
endif()
```

## prj.conf
```kconfig
# IWSCK A1 — Bring-up shell application

# Shell
CONFIG_SHELL=y
CONFIG_SHELL_BACKEND_SERIAL=y
CONFIG_SHELL_PROMPT_UART="iwsck> "

# Serial
CONFIG_SERIAL=y
CONFIG_CONSOLE=y
CONFIG_UART_CONSOLE=y
CONFIG_UART_INTERRUPT_DRIVEN=y
CONFIG_PRINTK=y

# Logging — minimal to reduce idle wakeups
CONFIG_LOG=y
CONFIG_LOG_MODE_MINIMAL=y

# GPIO + built-in shell
CONFIG_GPIO=y
CONFIG_GPIO_SHELL=y

# I2C (hardware TWI on P1.04/P1.05) + built-in shell
CONFIG_I2C=y
CONFIG_I2C_NRFX=y
CONFIG_I2C_SHELL=y

# Sensor (die temp only — ADC/SPI/PWM not needed)
CONFIG_SENSOR=y

# BLE GATT server
CONFIG_BT=y
CONFIG_BT_DEVICE_NAME="IWSCK-A1"
CONFIG_BT_PERIPHERAL=y
CONFIG_BT_DEVICE_NAME_DYNAMIC=y
CONFIG_BT_GATT_DYNAMIC_DB=y

# NFC
CONFIG_NFC_T2T_NRFXLIB=y
CONFIG_NFC_NDEF=y
CONFIG_NFC_NDEF_MSG=y
CONFIG_NFC_NDEF_RECORD=y
CONFIG_NFC_NDEF_TEXT_RECORD=y

# LF clock — no LFXO, use internal RC 32KHz
CONFIG_CLOCK_CONTROL=y
CONFIG_CLOCK_CONTROL_NRF=y
CONFIG_CLOCK_CONTROL_NRF_K32SRC_RC=y
CONFIG_CLOCK_CONTROL_NRF_K32SRC_RC_CALIBRATION=y
CONFIG_CLOCK_CONTROL_NRF_K32SRC_250PPM=y

# System
CONFIG_MAIN_STACK_SIZE=4096
CONFIG_HEAP_MEM_POOL_SIZE=4096
CONFIG_REBOOT=y

# Power management — enable idle power saving
CONFIG_PM=y
CONFIG_PM_DEVICE=y
CONFIG_PM_DEVICE_RUNTIME=y

# Reduce system tick frequency for lower idle power
CONFIG_SYS_CLOCK_TICKS_PER_SEC=1000
```

## prj_beacon.conf
```kconfig
# IWSCK A1 — Permanent BLE + NFC beacon (headless)

# NO shell, NO console — headless operation
# CONFIG_SHELL is not set
# CONFIG_CONSOLE is not set
# CONFIG_UART_CONSOLE is not set
CONFIG_SERIAL=n
CONFIG_PRINTK=n

# GPIO (LEDs)
CONFIG_GPIO=y

# Sensor (die temp for BLE notify)
CONFIG_SENSOR=y

# BLE — connectable GATT server, always advertising
CONFIG_BT=y
CONFIG_BT_DEVICE_NAME="IWSCK-A1"
CONFIG_BT_PERIPHERAL=y
CONFIG_BT_GATT_DYNAMIC_DB=y

# NFC T2T tag
CONFIG_NFC_T2T_NRFXLIB=y
CONFIG_NFC_NDEF=y
CONFIG_NFC_NDEF_MSG=y
CONFIG_NFC_NDEF_RECORD=y
CONFIG_NFC_NDEF_TEXT_RECORD=y

# LF clock — no LFXO on board, use internal RC 32KHz
CONFIG_CLOCK_CONTROL=y
CONFIG_CLOCK_CONTROL_NRF=y
CONFIG_CLOCK_CONTROL_NRF_K32SRC_RC=y
CONFIG_CLOCK_CONTROL_NRF_K32SRC_RC_CALIBRATION=y
CONFIG_CLOCK_CONTROL_NRF_K32SRC_250PPM=y

# System
CONFIG_MAIN_STACK_SIZE=4096
CONFIG_HEAP_MEM_POOL_SIZE=4096

# Power management — idle enters low-power automatically
CONFIG_PM=y
CONFIG_PM_DEVICE=y

# Slow tick for lower idle power
CONFIG_SYS_CLOCK_TICKS_PER_SEC=1000
```

## prj_noshell.conf
```kconfig
# IWSCK A0 — No-shell ultra-low-power BLE beacon

# NO shell, NO console
# CONFIG_SHELL is not set
# CONFIG_CONSOLE is not set
# CONFIG_UART_CONSOLE is not set
CONFIG_SERIAL=n

# NO logging
# CONFIG_LOG is not set
CONFIG_PRINTK=n

# GPIO (for LEDs, fuel gauge GE)
CONFIG_GPIO=y

# BLE — just advertising
CONFIG_BT=y
CONFIG_BT_DEVICE_NAME="IWSCK-A0"
CONFIG_BT_PERIPHERAL=y

# LF clock — no LFXO on board
CONFIG_CLOCK_CONTROL=y
CONFIG_CLOCK_CONTROL_NRF=y
CONFIG_CLOCK_CONTROL_NRF_K32SRC_RC=y
CONFIG_CLOCK_CONTROL_NRF_K32SRC_RC_CALIBRATION=y
CONFIG_CLOCK_CONTROL_NRF_K32SRC_250PPM=y

# System
CONFIG_MAIN_STACK_SIZE=2048
CONFIG_HEAP_MEM_POOL_SIZE=2048

# Power management
CONFIG_PM=y
CONFIG_PM_DEVICE=y

# Slow tick
CONFIG_SYS_CLOCK_TICKS_PER_SEC=1000
```

## src/main.c
```c
/*
 * IWSCK — Bring-up shell (A0 + A1)
 *
 * All peripherals self-init via SYS_INIT:
 *   led.c    — RGB LED control          (pri 90)
 *   rs232.c  — RS232/LEMO uart20        (pri 91)
 *   fuel.c   — BQ35100 fuel gauge + INT (pri 92)
 *   ble.c    — BLE GATT server          (lazy, on first `ble start`)
 *
 * Built-in shells (gpio, i2c, sensor, kernel) via Kconfig.
 */

#include <zephyr/kernel.h>
#include <zephyr/shell/shell.h>
#include <zephyr/drivers/sensor.h>
#include <zephyr/drivers/clock_control.h>

#ifdef CONFIG_BOARD_IWSCK_A0
#define BOARD_NAME    "IWSCK A0"
#define CONSOLE_PINS  "P0.02/P0.03"
#define RS232_PINS    "P1.03/P1.02"
#define I2C_TYPE      "i2c_bb  P2.00/P2.01  100kHz"
#define LED_PINS      "P2.08(G) P2.09(B) P2.10(R) active-low"
#define FUEL_EN_PIN   "P0.01 (output, high)"
#define FUEL_INT_PIN  "P0.00 (active-low)"
#define NFC_STATUS    "disabled (reworked to RS232)"
#else
#define BOARD_NAME    "IWSCK A1"
#define CONSOLE_PINS  "P0.00/P0.01"
#define RS232_PINS    "P1.08/P1.09"
#define I2C_TYPE      "twim21  P1.04/P1.05  100kHz"
#define LED_PINS      "P2.07(R) P2.08(G) P2.09(B) active-low"
#define FUEL_EN_PIN   "P0.03 (output, high)"
#define FUEL_INT_PIN  "P0.02 (active-low)"
#define NFC_STATUS    "nfct    P1.02/P1.03"
#endif

static const struct device *const temp_dev =
	DEVICE_DT_GET(DT_NODELABEL(temp));
static const struct device *const clk_dev =
	DEVICE_DT_GET(DT_NODELABEL(clock));

static int cmd_board_info(const struct shell *sh, size_t argc, char **argv)
{
	ARG_UNUSED(argc); ARG_UNUSED(argv);
	shell_print(sh, BOARD_NAME " — nRF54L15 Bring-Up Board");
	shell_print(sh, "");
	shell_print(sh, "Pinout:");
	shell_print(sh, "  Console:    uart30  %s  115200", CONSOLE_PINS);
	shell_print(sh, "  RS232/LEMO: uart20  %s  115200", RS232_PINS);
	shell_print(sh, "  I2C:        %s", I2C_TYPE);
	shell_print(sh, "  NFC:        %s", NFC_STATUS);
	shell_print(sh, "  LEDs:       %s", LED_PINS);
	shell_print(sh, "  Fuel EN:    %s", FUEL_EN_PIN);
	shell_print(sh, "  Fuel INT:   %s", FUEL_INT_PIN);
	if (device_is_ready(temp_dev)) {
		struct sensor_value val;
		sensor_sample_fetch(temp_dev);
		sensor_channel_get(temp_dev, SENSOR_CHAN_DIE_TEMP, &val);
		shell_print(sh, "Die temp:     %d.%d C", val.val1, val.val2 / 100000);
	}
	shell_print(sh, "Uptime:       %lld ms", k_uptime_get());
	shell_print(sh, "HF clock:     HFXO 32MHz %s",
		    device_is_ready(clk_dev) ? "OK" : "FAIL");
	shell_print(sh, "LF clock:     RC32K (no LFXO)");
	return 0;
}
SHELL_CMD_REGISTER(board, NULL, "Board info, pinout, die temp", cmd_board_info);

int main(void)
{
	printk("\n========================================\n");
	printk("  " BOARD_NAME " — Bring-Up Shell\n");
	printk("  Type 'help' for commands\n");
	printk("========================================\n\n");
	return 0;
}
```

## src/ble.c
```c
/* BLE GATT server — connectable, notify die temp + fuel voltage every 2s */

#include <zephyr/kernel.h>
#include <zephyr/shell/shell.h>
#include <zephyr/drivers/sensor.h>
#include <zephyr/drivers/i2c.h>
#include <zephyr/bluetooth/bluetooth.h>
#include <zephyr/bluetooth/gatt.h>
#include <zephyr/bluetooth/conn.h>
#include <string.h>

static const struct device *const temp_dev = DEVICE_DT_GET(DT_NODELABEL(temp));
/* I2C bus: hardware TWIM21 on A1, bit-bang on A0 */
#if DT_NODE_HAS_STATUS_OKAY(DT_NODELABEL(i2c21))
static const struct device *const i2c_dev = DEVICE_DT_GET(DT_NODELABEL(i2c21));
#else
static const struct device *const i2c_dev = DEVICE_DT_GET(DT_NODELABEL(i2c_bb));
#endif

static bool advertising;
static bool ready;
static bool notifying;
static struct bt_conn *conn_ref;

/* Custom service */
#define SVC_UUID  BT_UUID_128_ENCODE(0x12345678,0x1234,0x5678,0x1234,0x56789abcdef0)
#define CHAR_UUID BT_UUID_128_ENCODE(0x12345678,0x1234,0x5678,0x1234,0x56789abcdef1)

static struct bt_uuid_128 svc_uuid = BT_UUID_INIT_128(SVC_UUID);
static struct bt_uuid_128 char_uuid = BT_UUID_INIT_128(CHAR_UUID);

static const struct bt_data ad[] = {
	BT_DATA_BYTES(BT_DATA_FLAGS, BT_LE_AD_GENERAL | BT_LE_AD_NO_BREDR),
};
static const struct bt_data sd[] = {
	BT_DATA(BT_DATA_NAME_COMPLETE, CONFIG_BT_DEVICE_NAME,
		sizeof(CONFIG_BT_DEVICE_NAME) - 1),
};

struct __packed status_pkt {
	int16_t  die_temp_c10;
	uint32_t uptime_s;
	uint16_t voltage_mv;
};

static void ccc_changed(const struct bt_gatt_attr *attr, uint16_t value)
{
	notifying = (value == BT_GATT_CCC_NOTIFY);
	printk("BLE notify %s\n", notifying ? "on" : "off");
}

BT_GATT_SERVICE_DEFINE(iwsck_svc,
	BT_GATT_PRIMARY_SERVICE(&svc_uuid),
	BT_GATT_CHARACTERISTIC(&char_uuid.uuid, BT_GATT_CHRC_NOTIFY,
			       BT_GATT_PERM_NONE, NULL, NULL, NULL),
	BT_GATT_CCC(ccc_changed, BT_GATT_PERM_READ | BT_GATT_PERM_WRITE),
);

static void notify_work_fn(struct k_work *w);
K_WORK_DELAYABLE_DEFINE(notify_work, notify_work_fn);

static void notify_work_fn(struct k_work *w)
{
	if (!notifying || !conn_ref) return;

	struct status_pkt pkt = {0};
	if (device_is_ready(temp_dev)) {
		struct sensor_value v;
		sensor_sample_fetch(temp_dev);
		sensor_channel_get(temp_dev, SENSOR_CHAN_DIE_TEMP, &v);
		pkt.die_temp_c10 = (int16_t)(v.val1 * 10 + v.val2 / 100000);
	}
	pkt.uptime_s = (uint32_t)(k_uptime_get() / 1000);

	uint16_t volt;
	if (i2c_burst_read(i2c_dev, 0x55, 0x08, (uint8_t *)&volt, 2) == 0)
		pkt.voltage_mv = volt;

	bt_gatt_notify(conn_ref, &iwsck_svc.attrs[1], &pkt, sizeof(pkt));
	k_work_reschedule(&notify_work, K_SECONDS(2));
}

static void on_connected(struct bt_conn *conn, uint8_t err)
{
	if (err) { printk("BLE connect err: %d\n", err); return; }
	conn_ref = bt_conn_ref(conn);
	printk("BLE connected\n");
}

static void on_disconnected(struct bt_conn *conn, uint8_t reason)
{
	printk("BLE disconnected (%u)\n", reason);
	notifying = false;
	if (conn_ref) { bt_conn_unref(conn_ref); conn_ref = NULL; }
	if (advertising)
		bt_le_adv_start(BT_LE_ADV_CONN_FAST_1, ad, ARRAY_SIZE(ad),
				sd, ARRAY_SIZE(sd));
}

BT_CONN_CB_DEFINE(conn_cbs) = {
	.connected = on_connected,
	.disconnected = on_disconnected,
};

static int cmd_start(const struct shell *sh, size_t argc, char **argv)
{
	if (!ready) {
		shell_print(sh, "Initializing BLE...");
		int err = bt_enable(NULL);
		if (err) { shell_error(sh, "bt_enable: %d", err); return err; }
		ready = true;
		shell_print(sh, "BLE ready");
	}
	if (advertising) { shell_warn(sh, "Already advertising"); return 0; }

	if (argc >= 2) bt_set_name(argv[1]);

	int err = bt_le_adv_start(BT_LE_ADV_CONN_FAST_1, ad, ARRAY_SIZE(ad),
				  sd, ARRAY_SIZE(sd));
	if (err) { shell_error(sh, "Adv start: %d", err); return err; }

	advertising = true;
	shell_print(sh, "BLE server started (%s)", bt_get_name());
	return 0;
}

static int cmd_stop(const struct shell *sh, size_t argc, char **argv)
{
	ARG_UNUSED(argc); ARG_UNUSED(argv);
	if (!advertising) { shell_warn(sh, "Not advertising"); return 0; }

	notifying = false;
	k_work_cancel_delayable(&notify_work);
	if (conn_ref) bt_conn_disconnect(conn_ref, BT_HCI_ERR_REMOTE_USER_TERM_CONN);

	int err = bt_le_adv_stop();
	if (err) { shell_error(sh, "Stop: %d", err); return err; }

	advertising = false;
	shell_print(sh, "BLE stopped");
	return 0;
}

SHELL_STATIC_SUBCMD_SET_CREATE(sub_ble,
	SHELL_CMD(start, NULL, "Start GATT server [name]", cmd_start),
	SHELL_CMD(stop, NULL, "Stop server", cmd_stop),
	SHELL_SUBCMD_SET_END
);
SHELL_CMD_REGISTER(ble, &sub_ble, "BLE GATT server", NULL);
```

## src/fuel.c
```c
/* BQ35100 fuel gauge — I2C commands + interrupt + enable
 * A0: bit-bang I2C (i2c_bb), INT P0.00, EN P0.01
 * A1: hardware TWIM21 (i2c21), INT P0.02, EN P0.03
 */

#include <zephyr/kernel.h>
#include <zephyr/shell/shell.h>
#include <zephyr/drivers/gpio.h>
#include <zephyr/drivers/i2c.h>

/* I2C bus: hardware TWIM21 on A1, bit-bang on A0 */
#if DT_NODE_HAS_STATUS_OKAY(DT_NODELABEL(i2c21))
static const struct device *const i2c = DEVICE_DT_GET(DT_NODELABEL(i2c21));
#else
static const struct device *const i2c = DEVICE_DT_GET(DT_NODELABEL(i2c_bb));
#endif

/* Fuel gauge interrupt — P0.02, active-low */
static const struct gpio_dt_spec fuel_int =
	GPIO_DT_SPEC_GET(DT_NODELABEL(fuel_gauge_int), gpios);

/* Fuel gauge enable — P0.03, active-high */
static const struct gpio_dt_spec fuel_en =
	GPIO_DT_SPEC_GET(DT_NODELABEL(fuel_en), gpios);

static bool ge_enabled;

static int fuel_ge_init(void)
{
	if (!gpio_is_ready_dt(&fuel_en)) return -ENODEV;
	gpio_pin_configure_dt(&fuel_en, GPIO_OUTPUT_INACTIVE);
	return 0;
}
SYS_INIT(fuel_ge_init, APPLICATION, 89);

static void fuel_ge_on(void)
{
	if (!ge_enabled) {
		if (!gpio_is_ready_dt(&fuel_en)) {
			printk("[fuel] GE: gpio not ready!\n");
			return;
		}
		gpio_pin_set_dt(&fuel_en, 1);
		ge_enabled = true;
		k_msleep(1000); /* BQ35100 needs ~1s after GE rising edge for valid readings */
		printk("[fuel] GE enabled (P%d.%02d HIGH)\n",
		       fuel_en.port == DEVICE_DT_GET(DT_NODELABEL(gpio0)) ? 0 :
		       fuel_en.port == DEVICE_DT_GET(DT_NODELABEL(gpio1)) ? 1 : 2,
		       fuel_en.pin);
	}
}

#define ADDR 0x55

/* Registers */
#define REG_CONTROL 0x00
#define REG_ACAP    0x02
#define REG_TEMP    0x06
#define REG_VOLT    0x08
#define REG_BSTAT   0x0A
#define REG_BALERT  0x0B
#define REG_CURR    0x0C
#define REG_MEAS_Z  0x22
#define REG_SOH     0x2E
#define REG_DCAP    0x3C

/* Control subcommands */
#define CNTL_DEVICE_TYPE  0x0001
#define CNTL_FW_VERSION   0x0002
#define CNTL_HW_VERSION   0x0003
#define CNTL_CHEM_ID      0x0006
#define CNTL_GAUGE_START  0x0011
#define CNTL_GAUGE_STOP   0x0012

static int rd16(uint8_t reg, uint16_t *val)
{
	uint8_t buf[2];
	int err = i2c_burst_read(i2c, ADDR, reg, buf, 2);
	if (err) return err;
	*val = buf[0] | (buf[1] << 8);
	return 0;
}

static int rd8(uint8_t reg, uint8_t *val)
{
	return i2c_burst_read(i2c, ADDR, reg, val, 1);
}

static int ctl(uint16_t subcmd)
{
	uint8_t buf[3] = {REG_CONTROL, subcmd & 0xFF, subcmd >> 8};
	return i2c_write(i2c, buf, 3, ADDR);
}

static int ctl_read(uint16_t subcmd, uint16_t *val)
{
	int err = ctl(subcmd);
	if (err) return err;
	k_msleep(10);
	return rd16(REG_CONTROL, val);
}

/* --- Interrupt on P0.02 --- */

static struct gpio_callback fuel_int_cb;
static volatile uint32_t fuel_int_count;
static volatile uint32_t fuel_int_last_ms;

static void fuel_int_handler(const struct device *port, struct gpio_callback *cb,
			     gpio_port_pins_t pins)
{
	ARG_UNUSED(port); ARG_UNUSED(cb); ARG_UNUSED(pins);
	fuel_int_count++;
	fuel_int_last_ms = k_uptime_get_32();
	printk("[fuel] INT! (#%u)\n", fuel_int_count);
}

static int fuel_int_init(void)
{
	if (!gpio_is_ready_dt(&fuel_int)) return 0;
	gpio_pin_configure_dt(&fuel_int, GPIO_INPUT);
	gpio_pin_interrupt_configure_dt(&fuel_int, GPIO_INT_EDGE_TO_ACTIVE);
	gpio_init_callback(&fuel_int_cb, fuel_int_handler, BIT(fuel_int.pin));
	gpio_add_callback(fuel_int.port, &fuel_int_cb);
	return 0;
}
SYS_INIT(fuel_int_init, APPLICATION, 92);

/* --- Shell commands --- */

static int cmd_read(const struct shell *sh, size_t argc, char **argv)
{
	ARG_UNUSED(argc); ARG_UNUSED(argv);
	uint16_t volt, temp, soh, acap, imp, dcap;
	int16_t curr;

	fuel_ge_on();
	if (rd16(REG_VOLT, &volt)) {
		shell_error(sh, "Read failed — device present?");
		return -EIO;
	}
	rd16(REG_TEMP, &temp);
	rd16(REG_CURR, (uint16_t *)&curr);
	rd16(REG_SOH, &soh);
	rd16(REG_ACAP, &acap);
	rd16(REG_MEAS_Z, &imp);
	rd16(REG_DCAP, &dcap);

	shell_print(sh, "Voltage:    %u mV", volt);
	shell_print(sh, "Temp:       %d C", ((int)temp - 2731) / 10);
	shell_print(sh, "Current:    %d mA", curr);
	shell_print(sh, "SOH:        %u %%", soh);
	shell_print(sh, "Capacity:   %u mAh", acap);
	shell_print(sh, "Design Cap: %u mAh", dcap);
	shell_print(sh, "Impedance:  %u mOhm", imp);
	return 0;
}

static int cmd_status(const struct shell *sh, size_t argc, char **argv)
{
	ARG_UNUSED(argc); ARG_UNUSED(argv);
	uint8_t bstat, balert;

	fuel_ge_on();
	if (rd8(REG_BSTAT, &bstat)) {
		shell_error(sh, "Read failed");
		return -EIO;
	}
	rd8(REG_BALERT, &balert);

	shell_print(sh, "Status: 0x%02X  Alert: 0x%02X", bstat, balert);
	shell_print(sh, "  GA=%d DSG=%d BATTPRES=%d EOS=%d SEALED=%d",
		    !!(bstat & 0x01), !!(bstat & 0x02), !!(bstat & 0x08),
		    !!(bstat & 0x40), !!(bstat & 0x80));
	shell_print(sh, "  IRQ count: %u (last: %u ms ago)",
		    fuel_int_count,
		    fuel_int_count ? (k_uptime_get_32() - fuel_int_last_ms) : 0);
	return 0;
}

static int cmd_info(const struct shell *sh, size_t argc, char **argv)
{
	ARG_UNUSED(argc); ARG_UNUSED(argv);
	uint16_t devtype, fwver, hwver, chemid;

	fuel_ge_on();
	if (ctl_read(CNTL_DEVICE_TYPE, &devtype)) {
		shell_error(sh, "Control read failed");
		return -EIO;
	}
	ctl_read(CNTL_FW_VERSION, &fwver);
	ctl_read(CNTL_HW_VERSION, &hwver);
	ctl_read(CNTL_CHEM_ID, &chemid);

	shell_print(sh, "Device: 0x%04X  FW: 0x%04X  HW: 0x%04X  Chem: 0x%04X",
		    devtype, fwver, hwver, chemid);
	return 0;
}

static int cmd_start(const struct shell *sh, size_t argc, char **argv)
{
	ARG_UNUSED(argc); ARG_UNUSED(argv);
	fuel_ge_on();
	if (ctl(CNTL_GAUGE_START)) { shell_error(sh, "Failed"); return -EIO; }
	shell_print(sh, "Gauge ACTIVE");
	return 0;
}

static int cmd_stop(const struct shell *sh, size_t argc, char **argv)
{
	ARG_UNUSED(argc); ARG_UNUSED(argv);
	fuel_ge_on();
	if (ctl(CNTL_GAUGE_STOP)) { shell_error(sh, "Failed"); return -EIO; }
	shell_print(sh, "Gauge SLEEP");
	return 0;
}

static int cmd_scan(const struct shell *sh, size_t argc, char **argv)
{
	ARG_UNUSED(argc); ARG_UNUSED(argv);
	fuel_ge_on();
	int found = 0;
	for (uint8_t a = 0x08; a <= 0x77; a++) {
		struct i2c_msg msg = {.buf = NULL, .len = 0,
				      .flags = I2C_MSG_WRITE | I2C_MSG_STOP};
		if (i2c_transfer(i2c, &msg, 1, a) == 0) {
			shell_print(sh, "  0x%02X%s", a, a == ADDR ? " (BQ35100)" : "");
			found++;
		}
	}
	shell_print(sh, "%d device(s)", found);
	return 0;
}

SHELL_STATIC_SUBCMD_SET_CREATE(sub_fuel,
	SHELL_CMD(read, NULL, "Voltage, temp, current, SOH, capacity", cmd_read),
	SHELL_CMD(status, NULL, "Status flags + IRQ count", cmd_status),
	SHELL_CMD(info, NULL, "Device type, FW, HW, chem ID", cmd_info),
	SHELL_CMD(start, NULL, "GAUGE_START (ACTIVE)", cmd_start),
	SHELL_CMD(stop, NULL, "GAUGE_STOP (SLEEP)", cmd_stop),
	SHELL_CMD(scan, NULL, "I2C bus scan", cmd_scan),
	SHELL_SUBCMD_SET_END
);
SHELL_CMD_REGISTER(fuel, &sub_fuel, "BQ35100 fuel gauge", NULL);
```

## src/led.c
```c
/* RGB LED control — active-low on GPIO port 2 */

#include <zephyr/kernel.h>
#include <zephyr/shell/shell.h>
#include <zephyr/drivers/gpio.h>
#include <string.h>

static const struct gpio_dt_spec leds[] = {
	GPIO_DT_SPEC_GET(DT_NODELABEL(led_red), gpios),
	GPIO_DT_SPEC_GET(DT_NODELABEL(led_green), gpios),
	GPIO_DT_SPEC_GET(DT_NODELABEL(led_blue), gpios),
};
static const char *led_names[] = {"red", "green", "blue"};

static int led_init_fn(void)
{
	for (int i = 0; i < 3; i++)
		gpio_pin_configure_dt(&leds[i], GPIO_OUTPUT_INACTIVE);
	return 0;
}
SYS_INIT(led_init_fn, APPLICATION, 90);

static int cmd_led(const struct shell *sh, size_t argc, char **argv)
{
	if (argc < 3) {
		shell_error(sh, "Usage: led <red|green|blue> <on|off|toggle>");
		return -EINVAL;
	}

	int idx = -1;
	for (int i = 0; i < 3; i++) {
		if (strcmp(argv[1], led_names[i]) == 0) { idx = i; break; }
	}
	if (idx < 0) {
		shell_error(sh, "Unknown LED: %s", argv[1]);
		return -EINVAL;
	}

	if (strcmp(argv[2], "on") == 0)          gpio_pin_set_dt(&leds[idx], 1);
	else if (strcmp(argv[2], "off") == 0)     gpio_pin_set_dt(&leds[idx], 0);
	else if (strcmp(argv[2], "toggle") == 0)  gpio_pin_toggle_dt(&leds[idx]);
	else {
		shell_error(sh, "Unknown action: %s", argv[2]);
		return -EINVAL;
	}

	shell_print(sh, "LED %s: %s", argv[1], argv[2]);
	return 0;
}

SHELL_CMD_REGISTER(led, NULL, "led <red|green|blue> <on|off|toggle>", cmd_led);
```

## src/main_beacon.c
```c
/*
 * IWSCK A1 — Permanent BLE + NFC beacon
 *
 * Boots headless, immediately starts:
 *   - BLE connectable advertising (GATT server with status notify)
 *   - NFC T2T tag emulation (NDEF text record)
 *
 * Runs indefinitely while power is applied. No shell, no UART.
 */

#include <zephyr/kernel.h>
#include <zephyr/drivers/sensor.h>
#include <zephyr/drivers/gpio.h>
#include <zephyr/bluetooth/bluetooth.h>
#include <zephyr/bluetooth/gatt.h>
#include <zephyr/bluetooth/conn.h>
#include <nfc_t2t_lib.h>
#include <nfc/ndef/msg.h>
#include <nfc/ndef/text_rec.h>
#include <string.h>

/* ---------------- BLE ---------------- */

#define SVC_UUID  BT_UUID_128_ENCODE(0x12345678,0x1234,0x5678,0x1234,0x56789abcdef0)
#define CHAR_UUID BT_UUID_128_ENCODE(0x12345678,0x1234,0x5678,0x1234,0x56789abcdef1)

static struct bt_uuid_128 svc_uuid  = BT_UUID_INIT_128(SVC_UUID);
static struct bt_uuid_128 char_uuid = BT_UUID_INIT_128(CHAR_UUID);

static bool notifying;
static struct bt_conn *conn_ref;

static const struct bt_data ad[] = {
	BT_DATA_BYTES(BT_DATA_FLAGS, BT_LE_AD_GENERAL | BT_LE_AD_NO_BREDR),
};
static const struct bt_data sd[] = {
	BT_DATA(BT_DATA_NAME_COMPLETE, CONFIG_BT_DEVICE_NAME,
		sizeof(CONFIG_BT_DEVICE_NAME) - 1),
};

struct __packed status_pkt {
	int16_t  die_temp_c10;
	uint32_t uptime_s;
};

static const struct device *const temp_dev = DEVICE_DT_GET(DT_NODELABEL(temp));

static void ccc_changed(const struct bt_gatt_attr *attr, uint16_t value)
{
	notifying = (value == BT_GATT_CCC_NOTIFY);
}

BT_GATT_SERVICE_DEFINE(iwsck_svc,
	BT_GATT_PRIMARY_SERVICE(&svc_uuid),
	BT_GATT_CHARACTERISTIC(&char_uuid.uuid, BT_GATT_CHRC_NOTIFY,
			       BT_GATT_PERM_NONE, NULL, NULL, NULL),
	BT_GATT_CCC(ccc_changed, BT_GATT_PERM_READ | BT_GATT_PERM_WRITE),
);

static void notify_work_fn(struct k_work *w);
K_WORK_DELAYABLE_DEFINE(notify_work, notify_work_fn);

static void notify_work_fn(struct k_work *w)
{
	if (!notifying || !conn_ref) {
		return;
	}

	struct status_pkt pkt = {0};
	if (device_is_ready(temp_dev)) {
		struct sensor_value v;
		sensor_sample_fetch(temp_dev);
		sensor_channel_get(temp_dev, SENSOR_CHAN_DIE_TEMP, &v);
		pkt.die_temp_c10 = (int16_t)(v.val1 * 10 + v.val2 / 100000);
	}
	pkt.uptime_s = (uint32_t)(k_uptime_get() / 1000);

	bt_gatt_notify(conn_ref, &iwsck_svc.attrs[1], &pkt, sizeof(pkt));
	k_work_reschedule(&notify_work, K_SECONDS(2));
}

static void on_connected(struct bt_conn *conn, uint8_t err)
{
	if (err) {
		return;
	}
	conn_ref = bt_conn_ref(conn);
}

static void on_disconnected(struct bt_conn *conn, uint8_t reason)
{
	ARG_UNUSED(reason);
	notifying = false;
	if (conn_ref) {
		bt_conn_unref(conn_ref);
		conn_ref = NULL;
	}
	/* Re-advertise after disconnect */
	bt_le_adv_start(BT_LE_ADV_CONN_FAST_1, ad, ARRAY_SIZE(ad),
			sd, ARRAY_SIZE(sd));
}

BT_CONN_CB_DEFINE(conn_cbs) = {
	.connected    = on_connected,
	.disconnected = on_disconnected,
};

static int ble_init(void)
{
	int err = bt_enable(NULL);
	if (err) {
		return err;
	}

	err = bt_le_adv_start(BT_LE_ADV_CONN_FAST_1, ad, ARRAY_SIZE(ad),
			      sd, ARRAY_SIZE(sd));
	return err;
}

/* ---------------- NFC ---------------- */

static uint8_t ndef_msg_buf[256];

static void nfc_callback(void *context, nfc_t2t_event_t event,
			 const uint8_t *data, size_t data_length)
{
	ARG_UNUSED(context);
	ARG_UNUSED(data);
	ARG_UNUSED(data_length);
	/* Nothing to do — tag just stays active */
}

static int nfc_init(void)
{
	int err = nfc_t2t_setup(nfc_callback, NULL);
	if (err) {
		return err;
	}

	static const char text[] = "IWSCK-A1";
	uint8_t lang_code[] = "en";
	uint32_t len = sizeof(ndef_msg_buf);

	NFC_NDEF_MSG_DEF(nfc_msg, 1);
	NFC_NDEF_TEXT_RECORD_DESC_DEF(text_rec, UTF_8, lang_code,
				      sizeof(lang_code) - 1,
				      (const uint8_t *)text, sizeof(text) - 1);

	err = nfc_ndef_msg_record_add(&NFC_NDEF_MSG(nfc_msg),
				      &NFC_NDEF_TEXT_RECORD_DESC(text_rec));
	if (err) {
		return err;
	}

	err = nfc_ndef_msg_encode(&NFC_NDEF_MSG(nfc_msg), ndef_msg_buf, &len);
	if (err) {
		return err;
	}

	err = nfc_t2t_payload_set(ndef_msg_buf, len);
	if (err) {
		return err;
	}

	return nfc_t2t_emulation_start();
}

/* ---------------- Main ---------------- */

int main(void)
{
	/* Start BLE advertising */
	ble_init();

	/* Start NFC tag emulation */
	nfc_init();

	/* Both peripherals run from ISR/radio context.
	 * Main thread sleeps forever — kernel idle handles low-power. */
	k_sleep(K_FOREVER);
	return 0;
}
```

## src/main_noshell.c
```c
/* Absolute minimum power test — no shell, no UART, no BLE.
 * Just init and sleep forever. */

#include <zephyr/kernel.h>

int main(void)
{
	k_sleep(K_FOREVER);
	return 0;
}
```

## src/nfc.c
```c
/* NFC T2T tag — emits NDEF text record readable by phone */

#include <zephyr/kernel.h>
#include <zephyr/shell/shell.h>
#include <nfc_t2t_lib.h>
#include <nfc/ndef/msg.h>
#include <nfc/ndef/text_rec.h>
#include <string.h>

static uint8_t ndef_msg_buf[256];
static bool nfc_active;

static void nfc_callback(void *context, nfc_t2t_event_t event,
			 const uint8_t *data, size_t data_length)
{
	ARG_UNUSED(context);
	ARG_UNUSED(data);
	ARG_UNUSED(data_length);

	switch (event) {
	case NFC_T2T_EVENT_FIELD_ON:
		printk("[nfc] Field ON\n");
		break;
	case NFC_T2T_EVENT_FIELD_OFF:
		printk("[nfc] Field OFF\n");
		break;
	default:
		break;
	}
}

static int cmd_start(const struct shell *sh, size_t argc, char **argv)
{
	if (nfc_active) {
		shell_warn(sh, "NFC already active");
		return 0;
	}

	const char *text = "IWSCK-A1";
	if (argc >= 2) {
		text = argv[1];
	}

	int err = nfc_t2t_setup(nfc_callback, NULL);
	if (err) {
		shell_error(sh, "nfc_t2t_setup: %d", err);
		return err;
	}

	uint8_t lang_code[] = "en";
	uint32_t len = sizeof(ndef_msg_buf);

	NFC_NDEF_MSG_DEF(nfc_msg, 1);
	NFC_NDEF_TEXT_RECORD_DESC_DEF(text_rec, UTF_8, lang_code,
				      sizeof(lang_code) - 1,
				      (uint8_t *)text, strlen(text));

	err = nfc_ndef_msg_record_add(&NFC_NDEF_MSG(nfc_msg),
				      &NFC_NDEF_TEXT_RECORD_DESC(text_rec));
	if (err) {
		shell_error(sh, "record_add: %d", err);
		return err;
	}

	err = nfc_ndef_msg_encode(&NFC_NDEF_MSG(nfc_msg), ndef_msg_buf, &len);
	if (err) {
		shell_error(sh, "encode: %d", err);
		return err;
	}

	err = nfc_t2t_payload_set(ndef_msg_buf, len);
	if (err) {
		shell_error(sh, "payload_set: %d", err);
		return err;
	}

	err = nfc_t2t_emulation_start();
	if (err) {
		shell_error(sh, "emulation_start: %d", err);
		return err;
	}

	nfc_active = true;
	shell_print(sh, "NFC tag active: \"%s\"", text);
	return 0;
}

static int cmd_stop(const struct shell *sh, size_t argc, char **argv)
{
	ARG_UNUSED(argc);
	ARG_UNUSED(argv);

	if (!nfc_active) {
		shell_warn(sh, "NFC not active");
		return 0;
	}

	nfc_t2t_emulation_stop();
	nfc_t2t_done();
	nfc_active = false;
	shell_print(sh, "NFC stopped");
	return 0;
}

SHELL_STATIC_SUBCMD_SET_CREATE(sub_nfc,
	SHELL_CMD_ARG(start, NULL, "Start NFC tag [text]", cmd_start, 1, 1),
	SHELL_CMD(stop, NULL, "Stop NFC tag", cmd_stop),
	SHELL_SUBCMD_SET_END
);
SHELL_CMD_REGISTER(nfc, &sub_nfc, "NFC T2T tag", NULL);
```

## src/power.c
```c
/* Low-power mode shell command — demonstrates nRF54L15 sleep current */

#include <zephyr/kernel.h>
#include <zephyr/shell/shell.h>
#include <zephyr/drivers/gpio.h>
#include <zephyr/drivers/uart.h>
#include <zephyr/pm/pm.h>
#include <zephyr/pm/policy.h>
#include <zephyr/pm/device.h>
#include <zephyr/bluetooth/bluetooth.h>
#include <zephyr/shell/shell_uart.h>

/* BLE advertising data — minimal for ultra-low-power mode */
static const struct bt_data ulp_ad[] = {
	BT_DATA_BYTES(BT_DATA_FLAGS, BT_LE_AD_GENERAL | BT_LE_AD_NO_BREDR),
};
static const struct bt_data ulp_sd[] = {
	BT_DATA(BT_DATA_NAME_COMPLETE, CONFIG_BT_DEVICE_NAME,
		sizeof(CONFIG_BT_DEVICE_NAME) - 1),
};

static int cmd_sleep(const struct shell *sh, size_t argc, char **argv)
{
	int seconds = 5;
	if (argc >= 2) {
		seconds = atoi(argv[1]);
		if (seconds < 1 || seconds > 60) {
			shell_error(sh, "Duration must be 1-60 seconds");
			return -EINVAL;
		}
	}

	shell_print(sh, "Sleeping for %d seconds (shell inactive)...", seconds);
	/* Flush shell output */
	k_msleep(100);

	/* Sleep — the kernel idle thread will invoke PM and enter low-power */
	k_sleep(K_SECONDS(seconds));

	shell_print(sh, "Woke up! Uptime: %lld ms", k_uptime_get());
	return 0;
}

static int cmd_idle(const struct shell *sh, size_t argc, char **argv)
{
	shell_print(sh, "Current idle stats:");
	shell_print(sh, "  Uptime: %lld ms", k_uptime_get());
#ifdef CONFIG_PM_DEVICE
	shell_print(sh, "  PM Device: enabled");
#else
	shell_print(sh, "  PM Device: disabled");
#endif
#ifdef CONFIG_PM_DEVICE_RUNTIME
	shell_print(sh, "  PM Device Runtime: enabled");
#else
	shell_print(sh, "  PM Device Runtime: disabled");
#endif
	return 0;
}

/* Deferred low-power entry — runs from system workqueue after shell has
 * fully processed the uninit and aborted its thread. */
static void enter_lowpower_work_fn(struct k_work *w);
K_WORK_DELAYABLE_DEFINE(enter_lowpower_work, enter_lowpower_work_fn);

static void enter_lowpower_work_fn(struct k_work *w)
{
	ARG_UNUSED(w);

	/* Disable UART peripheral — don't sleep here, this is syswork context */
	const struct device *uart30 = DEVICE_DT_GET(DT_NODELABEL(uart30));
	if (device_is_ready(uart30)) {
		uart_irq_rx_disable(uart30);
		uart_irq_tx_disable(uart30);
#ifdef CONFIG_PM_DEVICE
		pm_device_action_run(uart30, PM_DEVICE_ACTION_SUSPEND);
#endif
	}
	/* After this returns, with shell thread aborted and UART off,
	 * only idle + BT threads remain. System enters low-power idle. */
}

static void shell_uninit_cb(const struct shell *sh, int res)
{
	ARG_UNUSED(sh); ARG_UNUSED(res);
	/* Shell thread is about to abort. Schedule UART disable on syswork. */
	k_work_schedule(&enter_lowpower_work, K_MSEC(100));
}

static int cmd_ultralow(const struct shell *sh, size_t argc, char **argv)
{
	ARG_UNUSED(argc); ARG_UNUSED(argv);

	/* Step 1: Start BLE advertising */
	shell_print(sh, "Initializing BLE...");
	int err = bt_enable(NULL);
	if (err && err != -EALREADY) {
		shell_error(sh, "bt_enable: %d", err);
		return err;
	}

	/* Slow advertising: 1000ms interval for minimum power. */
	static const struct bt_le_adv_param ulp_adv_param =
		BT_LE_ADV_PARAM_INIT(BT_LE_ADV_OPT_CONN,
				     BT_GAP_ADV_SLOW_INT_MIN,  /* 1000ms */
				     BT_GAP_ADV_SLOW_INT_MAX,  /* 1200ms */
				     NULL);
	err = bt_le_adv_start(&ulp_adv_param, ulp_ad, ARRAY_SIZE(ulp_ad),
			      ulp_sd, ARRAY_SIZE(ulp_sd));
	if (err && err != -EALREADY) {
		shell_error(sh, "Adv start: %d", err);
		return err;
	}
	shell_print(sh, "BLE advertising as '%s'", bt_get_name());

	/* Step 2: Announce UART shutdown */
	shell_print(sh, "Disabling UART console — board will be headless + BLE only");
	shell_print(sh, "Power cycle to restore shell.");

	/* Step 3: Uninit shell — callback fires after shell thread aborts,
	 * which then disables UART. With no runnable threads left,
	 * the kernel idle thread takes over and enters low-power state. */
	shell_uninit(sh, shell_uninit_cb);
	return 0;
}

static int cmd_deadlow(const struct shell *sh, size_t argc, char **argv)
{
	ARG_UNUSED(argc); ARG_UNUSED(argv);

	shell_print(sh, "UART off, NO BLE — absolute floor test");
	shell_print(sh, "Power cycle to restore shell.");

	shell_uninit(sh, shell_uninit_cb);
	return 0;
}

SHELL_STATIC_SUBCMD_SET_CREATE(sub_power,
	SHELL_CMD_ARG(sleep, NULL, "Sleep N seconds (default 5)", cmd_sleep, 1, 1),
	SHELL_CMD(idle, NULL, "Show idle/PM status", cmd_idle),
	SHELL_CMD(ultralow, NULL, "BLE adv only — kills UART, lowest power", cmd_ultralow),
	SHELL_CMD(deadlow, NULL, "No BLE, no UART — absolute floor", cmd_deadlow),
	SHELL_SUBCMD_SET_END
);
SHELL_CMD_REGISTER(power, &sub_power, "Power management", NULL);
```

## src/rs232.c
```c
/* RS232/LEMO via uart20 — IRQ-driven RX, poll TX */

#include <zephyr/kernel.h>
#include <zephyr/shell/shell.h>
#include <zephyr/drivers/uart.h>
#include <string.h>

static const struct device *const dev = DEVICE_DT_GET_OR_NULL(DT_NODELABEL(uart20));

static volatile uint8_t rx_buf[256];
static volatile uint16_t rx_head;
static volatile uint16_t rx_tail;

static void irq_handler(const struct device *uart, void *user_data)
{
	ARG_UNUSED(user_data);
	while (uart_irq_update(uart) && uart_irq_is_pending(uart)) {
		if (uart_irq_rx_ready(uart)) {
			uint8_t buf[32];
			int len = uart_fifo_read(uart, buf, sizeof(buf));
			for (int i = 0; i < len; i++) {
				uint16_t next = (rx_head + 1) % sizeof(rx_buf);
				if (next != rx_tail) {
					rx_buf[rx_head] = buf[i];
					rx_head = next;
				}
			}
		}
	}
}

static int rx_get(uint8_t *c)
{
	if (rx_head == rx_tail) return -1;
	*c = rx_buf[rx_tail];
	rx_tail = (rx_tail + 1) % sizeof(rx_buf);
	return 0;
}

static void tx_str(const char *s)
{
	if (!dev || !device_is_ready(dev)) return;
	while (*s) uart_poll_out(dev, *s++);
}

static bool rs232_rx_active;

static void rs232_ensure_active(void)
{
	if (!rs232_rx_active && dev && device_is_ready(dev)) {
		uart_irq_callback_set(dev, irq_handler);
		uart_irq_rx_enable(dev);
		rs232_rx_active = true;
	}
}

/* Don't enable UART RX IRQ at boot — saves power when RS232 is unused */

static int cmd_send(const struct shell *sh, size_t argc, char **argv)
{
	rs232_ensure_active();
	if (argc < 2) {
		shell_error(sh, "Usage: rs232 send <text>");
		return -EINVAL;
	}
	for (size_t i = 1; i < argc; i++) {
		tx_str(argv[i]);
		if (i < argc - 1) uart_poll_out(dev, ' ');
	}
	tx_str("\r\n");
	shell_print(sh, "TX: %d arg(s)", (int)(argc - 1));
	return 0;
}

static int cmd_recv(const struct shell *sh, size_t argc, char **argv)
{
	ARG_UNUSED(argc); ARG_UNUSED(argv);
	rs232_ensure_active();
	uint8_t ch;
	int n = 0;
	while (rx_get(&ch) == 0) {
		shell_fprintf(sh, SHELL_NORMAL, (ch >= 0x20 && ch < 0x7F) ? "%c" : "\\x%02X", ch);
		n++;
	}
	shell_print(sh, n ? "\n[%d bytes]" : "(empty)", n);
	return 0;
}

static int cmd_loopback(const struct shell *sh, size_t argc, char **argv)
{
	ARG_UNUSED(argc); ARG_UNUSED(argv);
	rs232_ensure_active();
	uint8_t dummy;
	while (rx_get(&dummy) == 0) {}

	const char *test = "IWSCK-LOOPBACK-TEST";
	int len = strlen(test);
	tx_str(test);
	k_msleep(200);

	int ok = 0, idx = 0;
	uint8_t ch;
	while (rx_get(&ch) == 0 && idx < len) {
		if (ch == (uint8_t)test[idx]) ok++;
		else shell_warn(sh, "MISMATCH @%d: 0x%02X!=0x%02X", idx, test[idx], ch);
		idx++;
	}

	if (ok == len)
		shell_print(sh, "LOOPBACK PASS — %d/%d bytes", ok, len);
	else if (idx == 0)
		shell_error(sh, "NO RX DATA — check cable (LEMO pin 3->4)");
	else
		shell_error(sh, "LOOPBACK FAIL — %d/%d OK", ok, len);
	return 0;
}

SHELL_STATIC_SUBCMD_SET_CREATE(sub_rs232,
	SHELL_CMD(send, NULL, "TX text out RS232/LEMO", cmd_send),
	SHELL_CMD(recv, NULL, "Dump RX buffer", cmd_recv),
	SHELL_CMD(loopback, NULL, "Loopback test (LEMO 3->4)", cmd_loopback),
	SHELL_SUBCMD_SET_END
);
SHELL_CMD_REGISTER(rs232, &sub_rs232, "RS232/LEMO via uart20", NULL);
```
