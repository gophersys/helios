## apps/fixtures/mtib_sigma5/zephyr/dts/bindings/ti,sn74lv4051ad.yml
```yaml
description: "TI 8-channel mux"

compatible: "ti,sn74lv4051ad"

include: base.yaml

properties:
    select-gpios:
      type: phandle-array
      required: true
```

## apps/fixtures/mtib_zephyr/dts/bindings/bosch,bmp388_i2c.yml
```yaml
description: Bosch BMP388 Altimeter (I2C)

compatible: "bosch,bmp388-i2c"

include: base.yaml
on-bus: i2c

properties:
    int-gpios:
      type: phandle-array
      required: true
```

## concord/apps/firmware/icle/Kconfig
```kconfig
# SPDX-License-Identifier: Apache-2.0
# ICLE Super Monitor Kconfig

mainmenu "ICLE Super Monitor Configuration"

source "Kconfig.zephyr"

# Network Control Service (ported from Helios runtime)
rsource "src/services/netctl/Kconfig"

menu "ICLE Application Settings"

config ICLE_WIFI_SSID
	string "Default WiFi SSID"
	default "CoreKinect_2G"
	help
	  Default WiFi network SSID for initial connection.
	  Can be overridden at runtime via Config Mode.

config ICLE_WIFI_PSK
	string "Default WiFi Password"
	default "Trap101!"
	help
	  Default WiFi network password for initial connection.
	  Can be overridden at runtime via Config Mode.

config ICLE_BACKEND_URL
	string "Backend API URL"
	default "http://concord.ad.corekinect.com/api"
	help
	  Base URL for the Concord backend API.
	  Used for log sync and configuration.

config ICLE_DEVICE_ID
	string "Device ID"
	default "icle-001"
	help
	  Unique identifier for this ICLE device.
	  Used for backend registration and log attribution.

config ICLE_SAMPLE_INTERVAL_MS
	int "Sample interval (ms)"
	default 100
	range 10 10000
	help
	  Interval between power measurements in Logger Mode.
	  Lower values = higher resolution but more data.

config ICLE_SYNC_INTERVAL_MS
	int "HTTP sync interval (ms)"
	default 60000
	range 5000 3600000
	help
	  Interval between HTTP sync attempts in Logger Mode.
	  Set higher to reduce network traffic.

config ICLE_CONFIG_TIMEOUT_MS
	int "Config mode timeout (ms)"
	default 300000
	range 60000 3600000
	help
	  Idle timeout before returning to deep sleep from Config Mode.
	  Default is 5 minutes (300000 ms).

config ICLE_LOG_FORMAT_CSV
	bool "Use CSV log format (instead of binary)"
	default n
	help
	  If enabled, logs are stored as CSV files.
	  Binary format is more compact but less human-readable.

config ICLE_LOG_MAX_SIZE
	int "Maximum log file size (bytes)"
	default 1048576
	range 65536 16777216
	help
	  Maximum size of a single log file before rotation.
	  Default is 1MB (1048576 bytes).

config ICLE_AUTO_WIFI_CONNECT
	bool "Auto-connect to WiFi on boot"
	default y
	depends on WIFI
	help
	  Automatically connect to WiFi on boot using configured SSID/PSK

config ICLE_LED_BLINK_INTERVAL_MS
	int "LED blink interval (ms)"
	default 500
	help
	  Interval for status LED blinking

endmenu
```

## concord/libs/zephyr/bq35100_drv/Kconfig
```kconfig
# Copyright (c) 2024 CoreKinect Inc.

menu "BQ35100 Primary Battery Fuel Gauge Driver"

menuconfig CK_BQ35100
    bool "Texas Instruments BQ35100 primary battery fuel gauge"
    depends on I2C && SENSOR
    help
      Enable support for the Texas Instruments BQ35100 primary battery
      fuel gauge with impedance tracking. Supports Li-SOCl2 and Li-MnO2
      chemistries with three gauging modes: Accumulator (coulomb counting),
      State-of-Health (voltage correlation), and End-of-Service (impedance
      correlation). Provides voltage, current, temperature, capacity,
      impedance, and SOH measurements via the Zephyr sensor API.

if CK_BQ35100

config CK_BQ35100_INIT_PRIORITY
    int "Initialization priority"
    default 90
    help
      Initialization priority for the BQ35100 driver.
      Should be initialized after the I2C bus driver.

config CK_BQ35100_LOG_LEVEL
    int "Log level"
    default 3
    range 0 4
    help
      Set the log level for the BQ35100 driver.
        0 = OFF  - No logging
        1 = ERR  - Error messages only
        2 = WRN  - Warnings and errors
        3 = INF  - Informational messages (default)
        4 = DBG  - Debug messages (verbose)

config CK_BQ35100_TRIGGER
    bool "Interrupt trigger support"
    depends on GPIO
    default y
    help
      Enable ALERT interrupt trigger support. The BQ35100 ALERT pin
      signals battery low, temperature threshold, SOH low, EOS
      detection, gauge done, and initialization complete events.
      Requires the alert-gpios property in devicetree.

config CK_BQ35100_SHELL
    bool "Shell commands"
    depends on SHELL
    default y
    help
      Enable shell commands for interactive BQ35100 diagnostics.
      Provides: bq35100 read, status, info, start, stop, unseal,
      seal, new_battery, and flash_read commands.

endif # CK_BQ35100

endmenu
```

## concord/libs/zephyr/bq35100_drv/tests/hardware/testcase.yaml
```yaml
tests:
  drivers.sensor.bq35100.hardware:
    tags: sensor fuel_gauge i2c hardware
    depends_on: i2c gpio
    platform_allow: iwsck_a0/nrf54l15/cpuapp
    harness: ztest
    extra_args:
      - BOARD_ROOT=${ZEPHYR_EXTRA_MODULES}/../../../ck_boards/current
      - DTS_ROOT=${ZEPHYR_EXTRA_MODULES}/../../../ck_boards/current
    timeout: 120
```

## libs/embedded/ck_board/testing/icle_v1_0/Kconfig.defconfig
```kconfig
# SPDX-License-Identifier: Apache-2.0

if BOARD_ICLE_V1_0_PROCPU

config BOARD
	default "icle_v1_0"

endif # BOARD_ICLE_V1_0_PROCPU
```

## libs/embedded/ck_board/testing/icle_v1_0/Kconfig.icle_v1_0
```kconfig
# SPDX-License-Identifier: Apache-2.0
# CoreKinect ICLE v1.0 board configuration

config BOARD_ICLE_V1_0
	bool "CoreKinect ICLE v1.0"
	depends on SOC_SERIES_ESP32
	select SOC_ESP32_WROOM_32UE
```

## libs/embedded/ck_wifi/Kconfig
```kconfig
# SPDX-License-Identifier: Apache-2.0
# CoreKinect WiFi Library Kconfig

menuconfig CK_WIFI
	bool "CoreKinect WiFi Library"
	depends on WIFI
	depends on NET_L2_WIFI_MGMT
	help
	  Enable CoreKinect WiFi helper library

if CK_WIFI

config CK_WIFI_SSID
	string "WiFi SSID"
	default ""
	help
	  WiFi network SSID to connect to

config CK_WIFI_PSK
	string "WiFi PSK"
	default ""
	help
	  WiFi network password (WPA2-PSK)

config CK_WIFI_CONNECT_TIMEOUT_MS
	int "WiFi connection timeout (ms)"
	default 30000
	help
	  Timeout for WiFi connection attempts

config CK_WIFI_LOG_LEVEL
	int "WiFi library log level"
	default 3
	help
	  Log level for WiFi library (0=off, 1=err, 2=wrn, 3=inf, 4=dbg)

endif # CK_WIFI
```

## libs/zephyr/bq35100_drv/dts/bindings/gauge/ti,bq35100.yaml
```yaml
# Copyright (c) 2024 CoreKinect Inc.

description: |
  Texas Instruments BQ35100 Primary Battery Fuel Gauge

  The BQ35100 is a fuel gauge and end-of-service monitor for primary
  (non-rechargeable) lithium batteries. It supports Li-SOCl2 and Li-MnO2
  chemistries with ultra-low quiescent current (50 nA when disabled).

  The device is host-controlled via the Gauge Enable (GE) pin — when GE
  is LOW the device draws ~50 nA. When GE is HIGH the device powers up,
  takes measurements, and communicates over I2C at address 0x55.

  Three gauging modes are available:
    - Accumulator (ACC): Coulomb counting, chemistry-independent
    - State-of-Health (SOH): Voltage correlation for Li-MnO2
    - End-of-Service (EOS): Impedance tracking for Li-SOCl2

  Example devicetree configuration:

    &i2c0 {
        bq35100: bq35100@55 {
            compatible = "ti,bq35100";
            reg = <0x55>;
            enable-gpios = <&gpio0 1 GPIO_ACTIVE_HIGH>;
            alert-gpios = <&gpio0 0 GPIO_ACTIVE_LOW>;
            design-capacity-mah = <2200>;
            gauging-mode = "accumulator";
        };
    };

compatible: "ti,bq35100"

include: [i2c-device.yaml]

properties:
  enable-gpios:
    type: phandle-array
    required: true
    description: |
      GPIO connected to the BQ35100 GE (Gauge Enable) pin.
      Must be configured as active-high output. When asserted, the
      device powers up and begins taking measurements. When deasserted,
      the device enters ultra-low-power shutdown (~50 nA).
      The driver waits 250ms after assertion for the device to be ready.

  alert-gpios:
    type: phandle-array
    required: false
    description: |
      GPIO connected to the BQ35100 ALERT pin (open-drain, active-low).
      Triggers on configurable events: battery low, temperature threshold,
      SOH low, end-of-service, gauge done, and initialization complete.
      Reading BatteryAlert() clears the interrupt.

  design-capacity-mah:
    type: int
    required: false
    default: 2200
    description: |
      Design capacity of the primary battery in milliamp-hours.
      Used for SOH percentage calculation. Should match the battery
      datasheet nominal capacity. Range: 1-65535 mAh.

  gauging-mode:
    type: string
    required: false
    default: "accumulator"
    enum:
      - "accumulator"
      - "soh"
      - "eos"
    description: |
      Gauging mode selection:
        "accumulator" - Coulomb counting, works with all chemistries.
                        Measures V/I/T every 1s while active.
        "soh"         - State-of-Health via voltage correlation.
                        For Li-MnO2 batteries only.
        "eos"         - End-of-Service via impedance tracking.
                        For Li-SOCl2 batteries only.

  power-up-delay-ms:
    type: int
    required: false
    default: 250
    description: |
      Delay in milliseconds after GE assertion before I2C communication.
      The BQ35100 requires at least 250ms to power up. Increase if
      communication fails after enable.
```

## libs/zephyr/bq35100_drv/samples/basic/sample.yaml
```yaml
sample:
  name: BQ35100 Basic Sample
  description: Demonstrates BQ35100 fuel gauge driver capabilities
common:
  tags: sensor fuel_gauge i2c
  depends_on: i2c gpio
  harness: console
  harness_config:
    type: one_line
    regex:
      - "BQ35100 Fuel Gauge Sample Application"
tests:
  sample.sensor.bq35100.basic:
    platform_allow: iwsck_a0/nrf54l15/cpuapp
    extra_args:
      - BOARD_ROOT=${ZEPHYR_EXTRA_MODULES}/../../../ck_boards/current
      - DTS_ROOT=${ZEPHYR_EXTRA_MODULES}/../../../ck_boards/current
```

## libs/zephyr/wifi/zephyr/Kconfig
```kconfig
config CK_ESP32_WIFI_LIB
    bool "DNSEC Library"
    select WIFI
    select WIFI_ESP32
    select NET_IPV4
    select NET_DHCPV4
    select NET_L2_WIFI_MGMT
    select NET_L2_ETHERNET
    select ESP32_WIFI_STA_AUTO_DHCPV4
    select NETWORKING
    select NET_CONFIG_SETTINGS
    select NET_MGMT
    select NET_MGMT_EVENT
    select NET_MGMT_EVENT_INFO
    
    select DNS_RESOLVER
    select NET_SOCKETS
    select NET_SOCKETS_POSIX_NAMES
```

## research/embedded/concord/apps/firmware/icle/src/services/netctl/Kconfig
```kconfig
# ICLE Network Control Service
# Ported from Helios runtime netctl module.

config ICLE_NETCTL
    bool "Network Control Service"
    default y
    select NETWORKING
    select NET_MGMT
    select NET_MGMT_EVENT
    select NET_MGMT_EVENT_INFO
    select NET_IPV4
    select NET_SOCKETS
    select NET_UDP
    select NET_TCP
    select DNS_RESOLVER
    imply WIFI if SOC_SERIES_ESP32
    help
      Network interface management (WiFi).
      Automatically enables the Zephyr networking stack, sockets,
      TCP/UDP, DNS, and network management event subsystem.

if ICLE_NETCTL

config ICLE_NETCTL_LOG_LEVEL
    int "netctl log level"
    default 3
    range 0 4
    help
      Set the log level for the netctl module.
      0=OFF 1=ERR 2=WRN 3=INF 4=DBG

config ICLE_NETCTL_THREAD_STACK_SIZE
    int "Thread stack size"
    default 4096
    range 2048 16384
    help
      Stack size in bytes for the netctl worker thread.

config ICLE_NETCTL_THREAD_PRIORITY
    int "Thread priority"
    default 8
    range 0 14
    help
      Zephyr preemptive priority for the netctl thread.

config ICLE_NETCTL_MAX_PROFILES
    int "Max connection profiles"
    default 4

config ICLE_NETCTL_PROFILE_NAME_MAX
    int "Max profile name length"
    default 32

config ICLE_NETCTL_EVENT_QUEUE_SIZE
    int "Event queue size"
    default 16
    help
      Number of events the netctl queue can buffer.

# WiFi
config ICLE_NETCTL_WIFI
    bool "WiFi support"
    default y
    depends on WIFI
    select NET_L2_WIFI_MGMT
    select NET_L2_ETHERNET
    select NET_DHCPV4
    select WIFI_NM

# ESP32 WiFi driver processes events on the system workqueue.
# The default stack (2048) overflows during connect/DHCP.
config SYSTEM_WORKQUEUE_STACK_SIZE
    default 4096 if ICLE_NETCTL_WIFI

config ICLE_NETCTL_WIFI_STA
    bool "WiFi Station mode"
    default y
    depends on ICLE_NETCTL_WIFI

config ICLE_NETCTL_WIFI_SCAN_MAX_RESULTS
    int "Max WiFi scan results"
    default 20
    depends on ICLE_NETCTL_WIFI

config ICLE_NETCTL_WIFI_CONNECT_TIMEOUT_SEC
    int "WiFi connection timeout (seconds)"
    default 30
    depends on ICLE_NETCTL_WIFI
    help
      Time in seconds to wait for WiFi connection + DHCP.

config ICLE_NETCTL_WIFI_CONNECT_RETRIES
    int "WiFi connection retry count"
    default 3
    depends on ICLE_NETCTL_WIFI
    help
      Number of connection attempts before giving up.
      Uses exponential backoff between retries.

config ICLE_NETCTL_WIFI_DISCONNECT_TIMEOUT_SEC
    int "WiFi disconnection timeout (seconds)"
    default 5
    depends on ICLE_NETCTL_WIFI

config ICLE_NETCTL_WIFI_SCAN_TIMEOUT_SEC
    int "WiFi scan timeout (seconds)"
    default 10
    depends on ICLE_NETCTL_WIFI

config ICLE_NETCTL_WIFI_RETRY_BASE_DELAY_MS
    int "WiFi retry base delay (milliseconds)"
    default 1000
    depends on ICLE_NETCTL_WIFI

config ICLE_NETCTL_WIFI_RETRY_MAX_DELAY_MS
    int "WiFi retry max delay (milliseconds)"
    default 10000
    depends on ICLE_NETCTL_WIFI

config ICLE_NETCTL_MAX_SUBSCRIBERS
    int "Max event subscribers"
    default 4

# ---------------------------------------------------------------
# Zephyr networking defaults
# ---------------------------------------------------------------

config NET_IPV6
    default n if ICLE_NETCTL

config NET_LOG
    default y if ICLE_NETCTL

config NET_MAX_CONTEXTS
    default 4 if ICLE_NETCTL

config NET_MGMT_EVENT_QUEUE_SIZE
    default 32 if ICLE_NETCTL

config NET_MGMT_EVENT_QUEUE_TIMEOUT
    default 10000 if ICLE_NETCTL

# DNS defaults
config DNS_RESOLVER_MAX_SERVERS
    default 2 if ICLE_NETCTL

config DNS_SERVER_IP_ADDRESSES
    default y if ICLE_NETCTL

config DNS_SERVER1
    default "8.8.8.8" if ICLE_NETCTL

config DNS_SERVER2
    default "8.8.4.4" if ICLE_NETCTL

config DNS_NUM_CONCUR_QUERIES
    default 2 if ICLE_NETCTL

config NET_SOCKETS_DNS_TIMEOUT
    default 10000 if ICLE_NETCTL

# ESP32 WiFi STA: auto-start DHCPv4 after association
config ESP32_WIFI_STA_AUTO_DHCPV4
    default y if ICLE_NETCTL_WIFI_STA

endif # ICLE_NETCTL
```

## research/embedded/concord/libs/embedded/ck_board/testing/icle_v1_0/icle_v1_0_procpu_defconfig
```kconfig
# SPDX-License-Identifier: Apache-2.0
# CoreKinect ICLE v1.0 default configuration

CONFIG_SOC_SERIES_ESP32=y
CONFIG_BOARD_ICLE_V1_0_PROCPU=y
CONFIG_SOC_ESP32_PROCPU=y

CONFIG_MAIN_STACK_SIZE=2048
CONFIG_HEAP_MEM_POOL_SIZE=32768

CONFIG_CONSOLE=y
CONFIG_UART_CONSOLE=y
CONFIG_SERIAL=y

CONFIG_GPIO=y
CONFIG_PINCTRL=y

CONFIG_I2C=y
CONFIG_SENSOR=y

CONFIG_SPI=y

CONFIG_CLOCK_CONTROL=y

CONFIG_ENTROPY_GENERATOR=y
CONFIG_ENTROPY_ESP32_RNG=y
```

## research/embedded/tools/sfd/testdata/minizephyr/dts/bindings/sensor/test,fakesensor.yaml
```yaml
description: Fake test sensor
compatible: "test,fakesensor"
include: sensor-device.yaml
on-bus: i2c
properties:
  int-gpios:
    type: phandle-array
```

## research/embedded/zephyr-cipher/samples/esp32_wifi_node/Kconfig
```kconfig
mainmenu "cipher_esp32"
config WIFI_SSID
	string "WiFi SSID"
	default ""
config WIFI_PSK
	string "WiFi PSK"
	default ""
config BENCH_PAYLOAD_SIZE
	int "Stream payload buffer size (bytes)"
	default 16384
source "Kconfig.zephyr"
```
