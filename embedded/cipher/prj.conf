## CMakeLists.txt
```
cmake_minimum_required(VERSION 3.20.0)

find_package(Zephyr)

project(cipher)

# Including the 'include' directory for the protocol
zephyr_include_directories(src/cipher/include)

target_sources(app PRIVATE src/main.c)
add_subdirectory(src/cipher)
add_subdirectory(src/autogen)
```

## prj.conf
```kconfig
# Logging
CONFIG_LOG=y
CONFIG_LOG_MODE_IMMEDIATE=y
# CONFIG_LOG_MODE_DEFERRED=y
CONFIG_BOOT_BANNER=n
CONFIG_ASSERT=y
CONFIG_POLL=y

# Scheduler
CONFIG_NUM_PREEMPT_PRIORITIES=121

# Thread analyzer
# CONFIG_THREAD_ANALYZER=y
# CONFIG_THREAD_ANALYZER_USE_LOG=y
# CONFIG_THREAD_ANALYZER_AUTO=y
# CONFIG_THREAD_ANALYZER_AUTO_INTERVAL=5

# Set log level to debug for maximum output
# CONFIG_LOG_DEFAULT_LEVEL=4

# Enable log processing at boot to capture early logs
# CONFIG_BOOT_TIME_MEASUREMENT=y

# General config
CONFIG_NEWLIB_LIBC=y
CONFIG_MAIN_STACK_SIZE=1200

# Networking config
CONFIG_NETWORKING=y
CONFIG_NET_LOOPBACK=y
CONFIG_NET_IPV4=y
CONFIG_NET_IPV6=n
CONFIG_NET_TCP=y
CONFIG_NET_SOCKETS=y
CONFIG_NET_SOCKETS_POSIX_NAMES=y

# Socket options
CONFIG_NET_CONTEXT_SNDTIMEO=y
CONFIG_NET_CONTEXT_RCVTIMEO=y

# Network driver config
# CONFIG_TEST_RANDOM_GENERATOR=y

# Network address config
CONFIG_NET_CONFIG_SETTINGS=y
CONFIG_NET_CONFIG_NEED_IPV4=y
CONFIG_NET_CONFIG_MY_IPV4_ADDR="192.168.0.10"
CONFIG_NET_CONFIG_MY_IPV4_NETMASK="255.0.0.0"

# Threads
CONFIG_PRINTK=y
CONFIG_HEAP_MEM_POOL_SIZE=256
CONFIG_ASSERT=y
CONFIG_GPIO=y

# Thread-Aware debugging
CONFIG_THREAD_MONITOR=y
CONFIG_INIT_STACKS=y
CONFIG_DEBUG_THREAD_INFO=y
CONFIG_THREAD_STACK_INFO=y
CONFIG_THREAD_NAME=y

# -- disable code optimization so we can debug
CONFIG_DEBUG_OPTIMIZATIONS=y
CONFIG_EXCEPTION_STACK_TRACE=y
CONFIG_DEBUG_INFO=y
CONFIG_ASSERT=y

# -- system debug options
# CONFIG_SYS_HEAP_VALIDATE=y
# CONFIG_STACK_SENTINEL=y
# CONFIG_USERSPACE=y

# Useful to detect stack overflows
# CONFIG_STACK_CANARIES=y
# CONFIG_DYNAMIC_OBJECTS=y
# CONFIG_HEAP_MEM_POOL_SIZE=100000
```

## src/main.c
```c
// Zephyr includes
#include <zephyr/kernel.h>
#include <zephyr/logging/log.h>
LOG_MODULE_REGISTER(app);

// Cipher includes
#include "cipher/test/include/cipher_tests.h"
#include "daemon/api.h"
#include "daemon/fifo.h"
#include "daemon/registry.h"
#include "utils/err.h"

// App includes
#include "autogen/autogen.h"

int main(void) {
    LOG_RAW("\n\n%s\n", "********** Cipher Protocol App **********");
    cipher_test_rpc();
}
```
