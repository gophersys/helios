## CMakeLists.txt
```
cmake_minimum_required(VERSION 3.20.0)

set(LIBS_ROOT "${CMAKE_CURRENT_SOURCE_DIR}/../../..")
list(APPEND ZEPHYR_EXTRA_MODULES
    ${LIBS_ROOT}/iface
    ${LIBS_ROOT}/cipher
    ${LIBS_ROOT}/ck_analyzer
)

find_package(Zephyr)
project(cipher-eth_uplink)

target_sources(app PRIVATE src/main.c)
```

## prj.conf
```kconfig
# Libraries
CONFIG_CK_IFACE_LIB_SOCKETS=y
CONFIG_CK_CIPHER_LIB=y

# Logging
CONFIG_LOG=y
CONFIG_LOG_MODE_IMMEDIATE=y

# System
CONFIG_MAIN_STACK_SIZE=8192

# Networking core (transport details are per-board: boards/*.conf)
CONFIG_NETWORKING=y
CONFIG_NET_IPV4=y

# Thread stacks: generous margin on top of the (fixed) 2048 library default
CONFIG_CK_CIPHER_IFACE_THREAD_STACK_SIZE=4096

# Packet analyzer: decoded packets on console
CONFIG_CK_PKT_ANALYZER=y
CONFIG_CK_PKT_ANALYZER_BACKEND_LOG=y
```

## boards/native_sim.conf
```kconfig
# native_sim: offload sockets to the HOST network stack (no TAP needed).
# The daemon's zsock_* calls become real Linux syscalls, so the sim reaches
# the LAN exactly like any process on the devbox.
CONFIG_NET_DRIVERS=y
CONFIG_NET_SOCKETS_OFFLOAD=y
CONFIG_NET_NATIVE_OFFLOADED_SOCKETS=y
CONFIG_ETH_NATIVE_TAP=n
CONFIG_NET_CONFIG_AUTO_INIT=n
# Host glibc has no mDNS; target the board's DHCP lease directly.
CONFIG_CIPHER_SAMPLE_SERVER_HOST="10.168.0.97"
```

## boards/native_sim_native_64.conf
```kconfig
# native_sim: offload sockets to the HOST network stack (no TAP needed).
# The daemon's zsock_* calls become real Linux syscalls, so the sim reaches
# the LAN exactly like any process on the devbox.
CONFIG_NET_DRIVERS=y
CONFIG_NET_SOCKETS_OFFLOAD=y
CONFIG_NET_NATIVE_OFFLOADED_SOCKETS=y
CONFIG_ETH_NATIVE_TAP=n
CONFIG_NET_CONFIG_AUTO_INIT=n
# Host glibc has no mDNS; target the board's DHCP lease directly.
CONFIG_CIPHER_SAMPLE_SERVER_HOST="10.168.0.97"
# Net backend: JSON events to the local collector
CONFIG_CK_PKT_ANALYZER_BACKEND_NET=y
CONFIG_CK_PKT_ANALYZER_NET_HOST="127.0.0.1"
CONFIG_CK_PKT_ANALYZER_NET_PORT=9999
```

## src/main.c
```c
// Cipher daemon: uplink (client) node.
//
// Boots the cipher daemon with a single CLIENT socket interface that
// connects to the downlink node. The peer is found by mDNS name
// (cipher-server.local) — DHCP + DNS, no static addresses anywhere.

// Zephyr includes
#include <zephyr/kernel.h>
#include <zephyr/logging/log.h>

// Cipher includes
#include <daemon/api.h>

LOG_MODULE_REGISTER(eth_uplink);

#define CIPHER_SERVER_HOST CONFIG_CIPHER_SAMPLE_SERVER_HOST
#define CIPHER_PORT 5555

static cipher_daemon_t daemon_inst;

static cipher_daemon_config_t daemon_cfg =
{
    .device_id = 0x0002,
    .num_client_ifaces = 1,
    .num_server_ifaces = 0,
    .client_ifaces =
    {
        {
            .type = IFACE_TYPE_SOCKET,
            .link = IFACE_LINK_TYPE_CLIENT,
            .p_host = (char *)CIPHER_SERVER_HOST,
            .port = CIPHER_PORT,
        },
    },
};

int main(void)
{
    LOG_INF("cipher uplink node booting (device id 0x%04x -> %s:%d)",
            daemon_cfg.device_id, CIPHER_SERVER_HOST, CIPHER_PORT);

    cipher_daemon_init(&daemon_cfg, &daemon_inst);
    cipher_daemon_start(&daemon_inst);

    while (true)
    {
        k_sleep(K_SECONDS(30));
        LOG_INF("uplink alive");
    }

    return 0;
}
```
