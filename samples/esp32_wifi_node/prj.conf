## CMakeLists.txt
```
cmake_minimum_required(VERSION 3.20.0)
set(LIBS_ROOT "${CMAKE_CURRENT_SOURCE_DIR}/../../..")
list(APPEND ZEPHYR_EXTRA_MODULES ${LIBS_ROOT}/iface ${LIBS_ROOT}/cipher ${LIBS_ROOT}/ck_analyzer)
find_package(Zephyr REQUIRED HINTS $ENV{ZEPHYR_BASE})
project(esp32_wifi_node)
# ESP32 RAM is tight (WiFi ~50KB); shrink the cipher packet-pipeline heaps.
zephyr_compile_definitions(CONFIG_NET_PACKETS_COUNT=6 CONFIG_LOCAL_PACKETS_COUNT=8)
target_sources(app PRIVATE src/main.c)
```

## Kconfig
```
mainmenu "cipher_esp32"
config WIFI_SSID
	string "WiFi SSID"
	default ""
config WIFI_PSK
	string "WiFi PSK"
	default ""
source "Kconfig.zephyr"
```

## prj.conf
```kconfig
# cipher + iface libs
CONFIG_CK_IFACE_LIB_SOCKETS=y
CONFIG_CK_CIPHER_LIB=y
CONFIG_CK_CIPHER_CLIENT_IFACE_COUNT=1
CONFIG_CK_CIPHER_SERVER_IFACE_COUNT=1

# WiFi + net
CONFIG_WIFI=y
CONFIG_NETWORKING=y
CONFIG_NET_L2_WIFI_MGMT=y
CONFIG_NET_IPV4=y
CONFIG_NET_UDP=y
CONFIG_NET_TCP=y
CONFIG_NET_DHCPV4=y
CONFIG_NET_MGMT=y
CONFIG_NET_MGMT_EVENT=y
CONFIG_NET_MGMT_EVENT_INFO=y
CONFIG_NET_CONFIG_SETTINGS=n
CONFIG_NET_SOCKETS=y

# headroom (WiFi driver heap + cipher packet heaps + streams)
CONFIG_HEAP_MEM_POOL_SIZE=16384
CONFIG_NET_PKT_RX_COUNT=12
CONFIG_NET_PKT_TX_COUNT=12
CONFIG_NET_BUF_RX_COUNT=24
CONFIG_NET_BUF_TX_COUNT=24
CONFIG_NET_MAX_CONTEXTS=24
CONFIG_NET_MAX_CONN=24
CONFIG_NET_TCP_TIME_WAIT_DELAY=250
CONFIG_MAIN_STACK_SIZE=6144
CONFIG_NET_TX_STACK_SIZE=4096
CONFIG_NET_RX_STACK_SIZE=4096
CONFIG_NET_MGMT_EVENT_STACK_SIZE=2048

# keep the data path quiet
CONFIG_LOG=y
CONFIG_LOG_MODE_DEFERRED=y
CONFIG_PRINTK=y
CONFIG_CK_CIPHER_IFACE_LOG_LEVEL=1
CONFIG_CK_CIPHER_SD_LOG_LEVEL=1
CONFIG_CK_CIPHER_STREAM_LOG_LEVEL=3
CONFIG_CK_CIPHER_REGISTRY_LOG_LEVEL=1
```

## src/main.c
```c
// Cipher node over WiFi (ESP32). Associates to the AP, waits for DHCP, then runs
// a cipher daemon as a stream sink so a peer can stream to it over WiFi. First
// cross-transport (WiFi) cell of the interop matrix.
#include <zephyr/kernel.h>
#include <zephyr/logging/log.h>
#include <zephyr/net/net_if.h>
#include <zephyr/net/net_mgmt.h>
#include <zephyr/net/net_event.h>
#include <zephyr/net/wifi_mgmt.h>
#include <zephyr/net/dhcpv4.h>
#include <zephyr/net/socket.h>
#include <string.h>

#include <daemon/api.h>
#include <corekinect/cipher/stream.h>

LOG_MODULE_REGISTER(cipher_esp32, LOG_LEVEL_INF);

#define CIPHER_PORT 5555
#define COLLECTOR_HOST "10.168.0.225"
#define COLLECTOR_PORT 9999

static struct net_mgmt_event_callback wifi_cb, ipv4_cb;
static volatile bool have_ip;
static struct k_sem connect_result;   /* given on each WiFi CONNECT_RESULT */
static volatile int connect_status;   /* 0 = associated, else failure reason */

static cipher_daemon_t daemon_inst;
static cipher_daemon_config_t daemon_cfg = {
    .device_id = 0x000A,   /* ESP32-A */
    .num_server_ifaces = 1,
    .server_ifaces = {{ .type = IFACE_TYPE_SOCKET, .link = IFACE_LINK_TYPE_SERVER, .port = CIPHER_PORT }},
};
static cipher_service_entry_t sink_services[] = {
    { .service = { .id = 200, .name = "sink", .allowed_hops = 1, .ops = NULL, .num_ops = 0 } },
};

static int metrics_sock = -1;
static struct sockaddr_in metrics_dest;
static void metrics_init(void)
{
    metrics_sock = zsock_socket(AF_INET, SOCK_DGRAM, IPPROTO_UDP);
    memset(&metrics_dest, 0, sizeof(metrics_dest));
    metrics_dest.sin_family = AF_INET;
    metrics_dest.sin_port = htons(COLLECTOR_PORT);
    zsock_inet_pton(AF_INET, COLLECTOR_HOST, &metrics_dest.sin_addr);
}
static void metrics_emit(const char *j, int n)
{
    if (metrics_sock >= 0)
        (void)zsock_sendto(metrics_sock, j, n, 0, (struct sockaddr *)&metrics_dest, sizeof(metrics_dest));
}

static void wifi_evt(struct net_mgmt_event_callback *cb, uint64_t evt, struct net_if *iface)
{
    if (evt == NET_EVENT_WIFI_CONNECT_RESULT) {
        const struct wifi_status *st = cb->info;
        connect_status = st->status;
        if (st->status == 0) {
            struct wifi_ps_params ps = { .enabled = WIFI_PS_DISABLED };
            net_mgmt(NET_REQUEST_WIFI_PS, iface, &ps, sizeof(ps));
            net_dhcpv4_start(iface);
        }
        k_sem_give(&connect_result);
    }
}
static void ipv4_evt(struct net_mgmt_event_callback *cb, uint64_t evt, struct net_if *iface)
{
    if (evt != NET_EVENT_IPV4_ADDR_ADD) return;
    for (int i = 0; i < NET_IF_MAX_IPV4_ADDR; i++) {
        struct net_if_addr *a = &iface->config.ip.ipv4->unicast[i].ipv4;
        if (a->addr_type != NET_ADDR_DHCP) continue;
        char buf[NET_IPV4_ADDR_LEN];
        net_addr_ntop(AF_INET, &a->address.in_addr, buf, sizeof(buf));
        LOG_INF("WiFi DHCP IP: %s", buf);
        have_ip = true;
    }
}

int main(void)
{
    net_mgmt_init_event_callback(&wifi_cb, wifi_evt, NET_EVENT_WIFI_CONNECT_RESULT);
    net_mgmt_add_event_callback(&wifi_cb);
    net_mgmt_init_event_callback(&ipv4_cb, ipv4_evt, NET_EVENT_IPV4_ADDR_ADD);
    net_mgmt_add_event_callback(&ipv4_cb);

    k_sem_init(&connect_result, 0, 1);
    struct net_if *iface = net_if_get_first_wifi();
    k_sleep(K_SECONDS(1));
    static struct wifi_connect_req_params p;
    p.ssid = (const uint8_t *)CONFIG_WIFI_SSID; p.ssid_length = strlen(CONFIG_WIFI_SSID);
    p.psk = (const uint8_t *)CONFIG_WIFI_PSK;   p.psk_length = strlen(CONFIG_WIFI_PSK);
    p.security = WIFI_SECURITY_TYPE_PSK; p.channel = WIFI_CHANNEL_ANY;
    p.band = WIFI_FREQ_BAND_2_4_GHZ; p.mfp = WIFI_MFP_OPTIONAL;

    // Retry until associated + DHCP, with EXPONENTIAL BACKOFF. A single patient
    // attempt reliably associates; hammering the AP with rapid retries makes a
    // consumer router rate-limit the MAC (every attempt then returns
    // CONN_TIMEOUT). Backing off gives both the driver and the AP time to
    // recover, so across a continuous reflash loop a fresh flash always comes up
    // on WiFi without intervention.
    int backoff_s = 5;
    for (int attempt = 1; !have_ip; attempt++) {
        LOG_INF("WiFi connect attempt %d to '%s'...", attempt, CONFIG_WIFI_SSID);
        k_sem_reset(&connect_result);
        connect_status = -1;
        net_mgmt(NET_REQUEST_WIFI_CONNECT, iface, &p, sizeof(p));
        if (k_sem_take(&connect_result, K_SECONDS(25)) == 0 && connect_status == 0) {
            for (int i = 0; i < 75 && !have_ip; i++) {
                k_sleep(K_MSEC(200));   /* associated — wait for the DHCP lease */
            }
        }
        if (have_ip) {
            break;
        }
        LOG_WRN("WiFi attempt %d failed (status=%d) — backoff %ds", attempt, connect_status, backoff_s);
        net_mgmt(NET_REQUEST_WIFI_DISCONNECT, iface, NULL, 0);
        k_sleep(K_SECONDS(backoff_s));
        if (backoff_s < 30) {
            backoff_s += 5;    /* 5,10,15,20,25,30,30... */
        }
    }

    LOG_INF("network up — starting cipher daemon (device 0x%04x, port %d)", daemon_cfg.device_id, CIPHER_PORT);
    cipher_daemon_init(&daemon_cfg, &daemon_inst);
    cipher_register_local_services(&daemon_inst, sink_services, ARRAY_SIZE(sink_services));
    cipher_daemon_start(&daemon_inst);
    metrics_init();

    uint32_t last = 0xFFFFFFFF;
    while (true) {
        k_sleep(K_MSEC(500));
        cipher_stream_rx_stats_t st;
        if (cipher_stream_get_last_rx(&daemon_inst, &st) && st.completion_id != last) {
            last = st.completion_id;
            uint32_t kib = st.duration_ms > 0 ? (uint32_t)((int64_t)st.received_len * 1000 / st.duration_ms / 1024) : 0;
            LOG_INF("STREAM %u bytes/%u chunks in %lld ms = %u KiB/s checksum %s",
                st.received_len, st.num_chunks, st.duration_ms, kib, st.checksum_ok ? "OK" : "BAD");
            char j[224];
            int n = snprintk(j, sizeof(j),
                "{\"kind\":\"stream\",\"node\":\"esp32a\",\"n\":%u,\"bytes\":%u,\"chunks\":%u,"
                "\"duration_ms\":%lld,\"kib_s\":%u,\"checksum_ok\":%s}",
                st.completion_id, st.received_len, st.num_chunks, st.duration_ms, kib,
                st.checksum_ok ? "true" : "false");
            metrics_emit(j, n);
        }
    }
    return 0;
}
```
