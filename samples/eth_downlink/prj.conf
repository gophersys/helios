## CMakeLists.txt
```
cmake_minimum_required(VERSION 3.20.0)

set(LIBS_ROOT "${CMAKE_CURRENT_SOURCE_DIR}/../../..")
list(APPEND ZEPHYR_EXTRA_MODULES
    ${LIBS_ROOT}/iface
    ${LIBS_ROOT}/cipher
    ${LIBS_ROOT}/ck_analyzer
)

find_package(Zephyr)
project(cipher-eth_downlink)

target_sources(app PRIVATE src/main.c)
```

## prj.conf
```kconfig
# Libraries
CONFIG_CK_IFACE_LIB_SOCKETS=y
CONFIG_CK_CIPHER_LIB=y

# Logging
CONFIG_LOG=y
CONFIG_LOG_MODE_IMMEDIATE=y

# System
CONFIG_TEST_RANDOM_GENERATOR=y
CONFIG_ENTROPY_GENERATOR=y
CONFIG_NEWLIB_LIBC=y
CONFIG_MAIN_STACK_SIZE=8192

# Networking: ethernet + DHCP
CONFIG_NETWORKING=y
CONFIG_NET_L2_ETHERNET=y
CONFIG_NET_CONFIG_AUTO_INIT=y
CONFIG_NET_CONFIG_SETTINGS=y
CONFIG_NET_IPV4=y
CONFIG_NET_UDP=y
CONFIG_NET_DHCPV4=y
CONFIG_NET_CONFIG_NEED_IPV4=y

# mDNS: advertise as cipher-server.local
CONFIG_NET_HOSTNAME_ENABLE=y
CONFIG_NET_HOSTNAME="cipher-server"
CONFIG_MDNS_RESPONDER=y

# Thread stacks: generous margin on top of the (fixed) 2048 library default
CONFIG_CK_CIPHER_IFACE_THREAD_STACK_SIZE=4096

# Packet analyzer: decoded cipher packets on the console
CONFIG_CK_PKT_ANALYZER=y
CONFIG_CK_PKT_ANALYZER_BACKEND_LOG=y
```

## src/main.c
```c
// Cipher daemon: downlink (server) node.
//
// Boots the cipher daemon with a single SERVER socket interface on the
// board's ethernet. The board leases an address over DHCP and advertises
// itself as cipher-server.local over mDNS, so the uplink node needs zero
// static network configuration to find it.

// Zephyr includes
#include <zephyr/kernel.h>
#include <zephyr/logging/log.h>

// Cipher includes
#include <daemon/api.h>

LOG_MODULE_REGISTER(eth_downlink);

#define CIPHER_PORT 5555

static cipher_daemon_t daemon_inst;

static cipher_daemon_config_t daemon_cfg =
{
    .device_id = 0x0001,
    .num_client_ifaces = 0,
    .num_server_ifaces = 1,
    .server_ifaces =
    {
        {
            .type = IFACE_TYPE_SOCKET,
            .link = IFACE_LINK_TYPE_SERVER,
            .port = CIPHER_PORT,
        },
    },
};

int main(void)
{
    LOG_INF("cipher downlink node booting (device id 0x%04x, port %d)",
            daemon_cfg.device_id, CIPHER_PORT);

    cipher_daemon_init(&daemon_cfg, &daemon_inst);
    cipher_daemon_start(&daemon_inst);

    while (true)
    {
        k_sleep(K_SECONDS(30));
        LOG_INF("downlink alive");
    }

    return 0;
}
```
