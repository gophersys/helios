## tools/sfd/testdata/minizephyr/dts/bindings/sensor/test,incsensor.yaml
```yaml
description: Sensor whose bus comes only via include
compatible: "test,incsensor"
include: [i2c-device.yaml]
```

## zephyr-cipher/samples/eth_uplink/Kconfig
```kconfig
# Sample-level options
config CIPHER_SAMPLE_SERVER_HOST
    string "Cipher server host (mDNS/DNS name or IPv4 literal)"
    default "cipher-server.local"

source "Kconfig.zephyr"
```

## zephyr-cipher/samples/matrix_node/boards/nucleo_h743zi.conf
```kconfig
CONFIG_NET_L2_ETHERNET=y
CONFIG_NET_CONFIG_AUTO_INIT=y
CONFIG_NET_CONFIG_SETTINGS=y
CONFIG_NET_CONFIG_NEED_IPV4=y
CONFIG_NET_HOSTNAME_ENABLE=y
CONFIG_NET_HOSTNAME="cipher-matrix"
CONFIG_NEWLIB_LIBC=y
CONFIG_MAIN_STACK_SIZE=8192
CONFIG_HEAP_MEM_POOL_SIZE=8192
CONFIG_CK_CIPHER_IFACE_THREAD_STACK_SIZE=4096
```

## zephyr-cipher/samples/wifi_provision/Kconfig
```kconfig
mainmenu "wifi_provision"
config WIFI_SSID
	string "WiFi SSID"
	default ""
config WIFI_PSK
	string "WiFi PSK"
	default ""
source "Kconfig.zephyr"
```

## zephyr-ck-analyzer/zephyr/Kconfig
```kconfig
menuconfig CK_PKT_ANALYZER
    bool "CoreKinect packet analyzer (iface + cipher observability)"
    help
      Wireshark-style capture of iface transport events and cipher packet
      headers. Off by default; all hooks compile to nothing when disabled.

if CK_PKT_ANALYZER

config CK_PKT_ANALYZER_BACKEND_LOG
    bool "Log backend: decoded packets on the Zephyr log"
    default y

config CK_PKT_ANALYZER_HEXDUMP
    bool "Hexdump payload bytes in the log backend"
    depends on CK_PKT_ANALYZER_BACKEND_LOG

config CK_PKT_ANALYZER_BACKEND_NET
    bool "Net backend: JSON events over UDP to a collector"
    select NET_UDP

config CK_PKT_ANALYZER_NET_HOST
    string "Collector host (name or IPv4)"
    depends on CK_PKT_ANALYZER_BACKEND_NET
    default "10.42.5.40"

config CK_PKT_ANALYZER_NET_PORT
    int "Collector UDP port"
    depends on CK_PKT_ANALYZER_BACKEND_NET
    default 9999

config CK_PKT_ANALYZER_LOG_LEVEL
    int "Analyzer log level"
    default 3

endif # CK_PKT_ANALYZER
```
