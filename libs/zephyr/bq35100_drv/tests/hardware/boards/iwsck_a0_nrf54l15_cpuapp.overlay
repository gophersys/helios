/* BQ35100 test overlay for IWSCK A0 */

&i2c_bb {
	status = "okay";

	bq35100: bq35100@55 {
		compatible = "ti,bq35100";
		reg = <0x55>;
		enable-gpios = <&gpio0 1 GPIO_ACTIVE_HIGH>;
		alert-gpios = <&gpio0 0 GPIO_ACTIVE_LOW>;
		design-capacity-mah = <2200>;
		gauging-mode = "accumulator";
	};
};
